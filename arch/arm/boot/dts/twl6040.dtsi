/*
 * Copyright (C) 2012 Texas Instruments Incorporated - http://www.ti.com/
 *
 * This program is free software; you can redistribute it and/or modify
 * it under the terms of the GNU General Public License version 2 as
 * published by the Free Software Foundation.
 */

/*
 * 8 channel high-quality low power audio codec
 * http://www.ti.com/lit/ds/symlink/twl6040.pdf
 */
&twl6040 {
	reg = <0x4b>;

	gpio-controller;
	#gpio-cells = <1>;
};
