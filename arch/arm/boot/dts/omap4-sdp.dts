/*
 * Copyright (C) 2011 Texas Instruments Incorporated - http://www.ti.com/
 *
 * This program is free software; you can redistribute it and/or modify
 * it under the terms of the GNU General Public License version 2 as
 * published by the Free Software Foundation.
 */
/dts-v1/;

/include/ "omap4.dtsi"

/ {
	model = "TI OMAP4 SDP board";
	compatible = "ti,omap4-sdp", "ti,omap4430", "ti,omap4";

	memory {
		device_type = "memory";
		reg = <0x80000000 0x40000000>; /* 1 GB */
	};

	keypad@4ae1c000 {
		keypad,num-rows = <8>;
		keypad,num-columns = <8>;
		linux,keymap = < 0x00000012
			0x00010013
			0x00020014
			0x00030066
			0x0004003f
			0x00060017
			0x0007002a
			0x01000020
			0x01010021
			0x01020022
			0x01030054
			0x01040040
			0x01060025
			0x0107001c
			0x0200002d
			0x0201002e
			0x0202002f
			0x0203006b
			0x02040041
			0x02060034
			0x0207003a
			0x0300002c
			0x0301004e
			0x03020030
			0x0303003b
			0x03040042
			0x03060018
			0x03070039
			0x04000011
			0x04010015
			0x04020016
			0x0403003c
			0x04040073
			0x04060026
			0x04070069
			0x0500001f
			0x05010023
			0x05020024
			0x0503003d
			0x05040043
			0x05050072
			0x05060032
			0x0507006a
			0x06000010
			0x0601001e
			0x06020031
			0x0603005c
			0x0604000e
			0x06060019
			0x06070067
			0x07000094
			0x07010095
			0x070200ca
			0x070300cb
			0x0704003e
			0x07060160
			0x0707006c >;
		linux,input-no-autorepeat;
	};
};
