## drivers/dsp/syslink/Kconfig
```kconfig
menuconfig Sys_Link
	bool "Sys_Link"
	depends on ARCH_OMAP4
	default y

if Sys_Link

config  SYSLINK_PROC
        tristate "Syslink ProcMgr"
        default y
	help
           Syslink Proc manager

config  SYSLINK_PROC4430
        tristate "Proc 4430"
        depends on SYSLINK_PROC
        default y
        help
           Ducati Proc implementation

config  DUCATI_BASEIMAGE_PHYS_ADDR
	hex "Physical Address where the Ducati is loaded"
	depends on SYSLINK_PROC4430
	default 0x9CF00000
	help
	  Specify the physical address where the Ducati image will be
	  loaded.

config  SYSLINK_DUCATI_PM
	bool "IPU Power Management"
	depends on SYSLINK_PROC
        default y
        help
	  Enables the options available for ipu_pm implementation

config  SYSLINK_IPU_SELF_HIBERNATION
	bool "Enable IPU Self hibernation"
	depends on SYSLINK_DUCATI_PM
	default y
	help
	  IPU will hibernate by it self after a configurable time, this
	  controls the self hibernation, IPU will hibernate when a system
	  suspend is executed and wake up when system resumes.

config  DUCATI_WATCH_DOG
	bool "Enable Ducati watch dog timer"
	depends on SYSLINK_IPU_SELF_HIBERNATION
	default y
	help
	  Ducati cores will trigger reset if any of the two M3 cores stop
	  responding after 7 seconds. Requires Hibernation enabled. If
	  hibernation is enabled, M3 cores go to hibernation after 5
	  seconds. Ducati cannot go to hibernation if fault occurs on one
	  of the M3 cores

config  SYSLINK_IPU_PM_TRACES
	bool "IPU PM Debug Traces"
	depends on SYSLINK_DUCATI_PM
	default n

config  OMAP_DEVICE_HANDLER
        tristate "Device Handler"
        depends on OMAP_IOMMU
        select OMAP_REMOTE_PROC
        select MPU_SYSLINK_IPC
        default y
        help
          Select this to enable the Device Handler.  The Device Handler
          is a module that handles device-specific events.  Events handled
          include process termination.

config MPU_SYSLINK_PLATFORM
        tristate "Syslink Platform Module"
        default y
        help
          Syslink Platform Module

config MPU_SYSLINK_IPC
        tristate "Syslink IPC Module"
        depends on SYSLINK_PROC4430
        default y
        select OMAP_MBOX_FWK
        select OMAP_REMOTE_PROC
        help
          Syslink IPC Module (includes Notify)

config SYSLINK_USE_SYSMGR
        bool "Enable SYS MGR setup"
        depends on MPU_SYSLINK_IPC && SYSLINK_PROC
        default y
        help
          This is the experimental option to enable SYS manager setup

config SYSLINK_IOMMU_ENABLE
        bool
        select OMAP_IOMMU
	select OMAP_USER_DMM
	default y

config SYSLINK_RECOVERY
        bool "Enable Syslink Fault Recovery"
	default y

config DMM_DMA_API
	bool "Enable DMA APIs for flushing"
	depends on SYSLINK_IOMMU_ENABLE
	default n
	help
	   Setting this would enable DMA APIs in Kernel for Mapped buffers
	   cache maintainance. Not setting this option will allow unrestricted
	   cache operations on the userspace buffers. This option would be
	   made default once the code is stabilized

endif
```

## drivers/gpu/ion/Kconfig
```kconfig
menuconfig ION
	tristate "Ion Memory Manager"
	select GENERIC_ALLOCATOR
	help
	  Chose this option to enable the ION Memory Manager.

config ION_TEGRA
	tristate "Ion for Tegra"
	depends on ARCH_TEGRA && ION
	help
	  Choose this option if you wish to use ion on an nVidia Tegra.

config ION_OMAP
	tristate "Ion for OMAP"
	depends on (ARCH_OMAP5 || ARCH_OMAP4) && ION && DRM_OMAP
	help
	  Choose this option if you wish to use ion on OMAP4/5.
	  This option shall be chosen if ion carveout is required
	  for OMAP4/5. The corresponding board file shall also have
	  the ion carveout implementation.
```

## drivers/i2c/SenseTek/Kconfig
```kconfig
#
# SenseTek I2C sensors drivers configuration
#
# Copyright (C) SenseTek/Sitronix 2010
# Patrick Chang patrick_chang@sitronix.com.tw

config SENSETEK_I2C_SENSORS
	bool "SenseTek I2C Sensors"
	depends on I2C
	help
	  Say Y here, and a list of miscellaneous sensor drivers will be displayed.
	  Everything that didn't fit into the other categories is here. This option
	  doesn't affect the kernel.

	  If unsure, say Y.

if SENSETEK_I2C_SENSORS

config STK_OPTICAL_SENSOR

	bool "SenseTek Optical Sensors"
	help
	  Say Y here, if you need ALS or PS+ALS.
if STK_OPTICAL_SENSOR
choice
prompt "SenseTek Optical Sensor Type"
default STK_PS
depends on STK_OPTICAL_SENSOR
config STK_ALS
	bool "Only SenseTek Ambient Light Sensor Generic Driver"
	help
	  Choice this if you want to enable SenseTek ALS.
	  ALS only, no proximity sensor.

config STK_PS
	bool "SenseTek Ambient Light Sensor + Proximity Sensor Generic Driver"
	---help---
	  Both support PS and ALS

endchoice

choice
depends on STK_PS
prompt "PS Driver Mode"
default STK_PS_SWITCH_MODE

config STK_PS_DISTANCE_MODE
	bool "Polling + Distance Mode"
	---help---
	Use polling thread to detect distance.
	Driver will report "distance"(uint : 10um) as input event

config STK_PS_SWITCH_MODE
	bool "Polling + Switch Mode"
	---help---
	Use polling thread to detech near or far.
	Driver will report "Near or Far" as input event

config STK_PS_INT_MODE
	bool "Interrupt + Switch Mode"
	---help---
	Use IC internal interrupt function to detect near or far.
	Becareful, please don't forget to connect your INT-pin to the chip and
	assign the correct IRQ number in your machine setting.
endchoice

choice
depends on STK_ALS
prompt "Select Sensor Model"
default STK_ALS_GENERIC
config STK_ALS_GENERIC
	bool "STK2201/2203"
	---help---
	Support for STK2201 and STK2203 (Generic)

config STK_ALS22x7
	bool "STK2207/2217"
	---help---
	Support for STK2207 and STK2217

endchoice

choice
depends on STK_ALS_GENERIC
prompt "Select I2C Slave Address"
default STK_ALS_SAHS_FLOAT
config STK_ALS_SAHS_FLOAT
	bool "SAHS is floating (0x20)"
	---help---
	0x20

config STK_ALS_SAHS_PULL_LOW
	bool "SAHS is pulling low (0x70)"
	---help---
	0x70

config STK_ALS_SAHS_PULL_HIGH
	bool "SAHS is pulling high (0x90)"
	---help---
	0x90

endchoice

choice
depends on STK_PS
prompt "Select I2C Slave Address"

config STK_PS_0x90
	bool "STK 3128 ADDR is conntect to GND or STK3101_90(0x90)"
	---help---
	0x90

config STK_PS_0xB0
	bool "STK 3128 ADDR is conntect to VDD or STK3101_B0(0xB0)"
	---help---
	0xB0

endchoice

config STK_PS_ALS_USE_CHANGE_THRESHOLD
    bool "Do NOT use lux look up-table for interrupt"
    depends on STK_PS_INT_MODE
    ---help---
    Check this if you want get more fine signal for light sensor.


config STK_ALS_CHANGE_THRESHOLD
	int "ALS Change Threshold (Lux)"
	depends on (STK_ALS||STK_PS_DISTANCE_MODE||STK_PS_SWITCH_MODE||STK_PS_ALS_USE_CHANGE_THRESHOLD)
	default "20"
	---help---
	  To determine the data will be returned or not. (in read() )
	  If difference >= Change Threshold ==>  the data will be returned
	  If difference <  Change Threshold ==>  retrun 0 bytes

config STK_ALS_SAMPLING_RATE
	int "ALS Sampling rate for internal data polling (HZ)"
	depends on (STK_ALS||STK_PS_DISTANCE_MODE||STK_PS_SWITCH_MODE)
	default "10"
	---help---
	  Depending on your r_set and IT.
	  If unsured, please use the default value (10).
config STK_PS_SAMPLING_RATE
	int "PS Sampling rate for internal data polling (HZ)"
	depends on (STK_PS_DISTANCE_MODE||STK_PS_SWITCH_MODE)
	default "50"
	---help---
	  Depending on PS_IT and PS_SLP.
	  Higher sampling rate will not gain any benefit, but more power consumption.
	  (But for ARM-base system, it is too little to be able to ignore it.


config STK_PS_CHANGE_THRESHOLD_NEAR
	int "Proximity sensor change threshold @ SHORT DISTANCE (UINT : 10um)"
	depends on STK_PS_DISTANCE_MODE
	default "400"
	---help---
	Default : 400 (means 0.4cm)

config STK_PS_CHANGE_THRESHOLD_MID
	int "Proximity sensor change threshold @ MID DISTANCE(UINT : 10um)"
	depends on STK_PS_DISTANCE_MODE
	default "800"
	---help---
	Default : 800 (means 0.8cm)

config STK_PS_CHANGE_THRESHOLD_FAR
	int "Proximity sensor change threshold @ LONG DISTANCE (UINT : 10um)"
	depends on STK_PS_DISTANCE_MODE
	default "4000"
	---help---
	Default : 4000 (means 4cm)

config STK_PS_DISTANCE_HIGH_THRESHOLD
	int "Proximity sensor high threshold (far) (UINT : 10um)"
	depends on (STK_PS_DISTANCE_MODE || STK_PS_SWITCH_MODE)
### 9 cm
	default "9000"
	---help---
	Default 9000, it means 9cm

config STK_PS_DISTANCE_LOW_THRESHOLD
	int "Proximity sensor low (near) threshold (UINT : 10um)"
	depends on (STK_PS_DISTANCE_MODE || STK_PS_SWITCH_MODE)
### 5 cm
	default "5000"
	---help---
	Default 5000, it means 5cm

config STK_PS_CODE_LOW_THRESHOLD
	int "Proximity sensor low (far) threshold (uint : code)"
	depends on STK_PS_INT_MODE
	default "40"
	---help---
	If ps_code < LOW_THD, it will trig interrupt.
	Default value = 40, and it is able to modify in ENG/DBG mode.

config STK_PS_CODE_HIGH_THRESHOLD
	int "Proximity sensor high (near) threshold (uint : code)"
	depends on STK_PS_INT_MODE
	default "150"
	---help---
	If ps_code > HIGH_THD, it will trig interrupt.
	Default value = 150, and it is able to modify in ENG/DBG mode.

choice
depends on STK_PS
prompt "PS Sleep Time"
default STK_PS_SLP01
config STK_PS_SLP00
	bool "Sleep Time = 10ms (SLP = 00)"
config STK_PS_SLP01
	bool "Sleep Time = 30ms (SLP = 01)"
config STK_PS_SLP10
	bool "Sleep Time = 90ms (SLP = 10)"
config STK_PS_SLP11
	bool "Sleep Time = 270ms (SLP = 11)"
endchoice


choice
depends on STK_PS
prompt "PS Integral Time"
default STK_PS_IT00
config STK_PS_IT00
	bool "Sleep Time = 200us (IT = 00)"
config STK_PS_IT01
	bool "Sleep Time = 300us (IT = 01)"
config STK_PS_IT10
	bool "Sleep Time = 400us (IT = 10)"
config STK_PS_IT11
	bool "Sleep Time = 500us (IT = 11)"
endchoice

choice
depends on STK_PS
prompt "PS IR-LED Driving Current"
default STK_PS_IRDR0
config STK_PS_IRDR0
	bool "Driving Current = 100mA (IRDR = 00)"
config STK_PS_IRDR1
	bool "Driving Current = 200mA (IRDR = 01)"
endchoice

config STK_PS_GAIN_SETTING
	hex "Proximity sensor Gain Setting"
	depends on STK_PS
	default "0x08"
	---help---
	0x0f~0x0f (See Reg81h Setting in Manual)
	If you don't understand this, please let it set to default value (0x08).

config STK_ALS_TRANSMITTANCE
	int "Transmittance (1/10,000)"
	depends on (STK_ALS||STK_PS)
	default "500"
	---help---
	 Depending on your cover lens and coating
 	 If unsured, please use the default value (500)
 	 500 means 5%

config CM_ALS_TRANSMITTANCE
	int "CM3263 Transmittance (1/10,000)"
	depends on (STK_ALS22x7)
	default "169"
	---help---
	Usually, this setting will be 1/4 of STK 2207 

config STK_SYSFS_DBG
    bool "Enable STK Optical Sensor Engineering Mode"
    depends on (STK_ALS||STK_PS)
    default n
    ---help---
    Provide serveral nodes to debug/tune performance or calbriate.
    It will be mounted on /sys/devices/platform/stk-oss/DBG.

config STK_ALS_TRANSMITTANCE_TUNING
    depends on ((STK_ALS || STK_PS) && STK_SYSFS_DBG)
    bool "Enable STK ALS Transmittance Tuning"
    default n
    ---help---
    Provide a node on SYSFS to tune transmittance parameter to meet you mech.
    Usually, you should enable this fuction during the enginner testing period.
    And turn off this fuction in retail/release version.

config STK_PS_ENGINEER_TUNING
    depends on (STK_PS && STK_SYSFS_DBG)
    bool "Enable STK PS Engineer Tuning"
    default n
    ---help---
    Mount a node on SYSFS to tune proximity sensor's parameter to meet you mech.
    Usually, you should enable this fuction during the enginner testing period.
    And turn off this fuction in retail/release version.

endif # STK_OPTICAL_SENSOR

config STK_SHOW_INFO
    bool "Enable Show Info"
    default y
    ---help---
    For debug

endif # SENSETEK_I2C_SENSORS
```

## drivers/i2c/chips/Kconfig
```kconfig
#
# Miscellaneous I2C chip drivers configuration
#
# *** DEPRECATED! Do not add new entries! See Makefile ***
#

menu "Miscellaneous I2C Chip support"

config DS1682
	tristate "Dallas DS1682 Total Elapsed Time Recorder with Alarm"
	depends on EXPERIMENTAL
	help
	  If you say yes here you get support for Dallas Semiconductor
	  DS1682 Total Elapsed Time Recorder.

	  This driver can also be built as a module.  If so, the module
	  will be called ds1682.

config TWL4030_POWEROFF
        bool "TWL4030 device poweroff"
        depends on TWL4030_CORE

config SENSORS_TSL2550
	tristate "Taos TSL2550 ambient light sensor"
	depends on EXPERIMENTAL
	help
	  If you say yes here you get support for the Taos TSL2550
	  ambient light sensor.

	  This driver can also be built as a module.  If so, the module
	  will be called tsl2550.

config SENSORS_PCA963X
	tristate "Philips PCA963X 4-bit I2C-bus LED"
	depends on I2C && EXPERIMENTAL
	help
	 If you say yes here you get support for the Philips PCA963X
	 4-bit I2C-bus LED.

	 This driver can also be built as a module.  If so, the module
	 will be called pca963X.

config TWL4030_MADC
	tristate "TWL4030 MADC Driver"
	depends on TWL4030_CORE
	help
	The TWL4030 Monitoring ADC driver enables the host
	processor to monitor analog signals using analog-to-digital
	conversions on the input source. TWL4030 MADC provides the
	following features:
	 - Single 10-bit ADC with successive approximation register (SAR) conversion;
	 - Analog multiplexer for 16 inputs;
	 - Seven (of the 16) inputs are freely available;
	 - Battery voltage monitoring;
	 - Concurrent conversion request management;
	 - Interrupt signal to Primary Interrupt Handler;
	 - Averaging feature;
	 - Selective enable/disable of the averaging feature.

	Say 'y' here to statically link this module into the kernel or 'm'
	to build it as a dinamically loadable module. The module will be
	called twl4030-madc.ko

endmenu
```

## drivers/mailbox/Kconfig
```kconfig
menuconfig MAILBOX
       bool "Mailbox Hardware Support"
       help
         Mailbox is a framework to control hardware communication between
         on-chip processors through queued messages and interrupt driven
         signals. Say Y if your platform supports hardware mailboxes.

if MAILBOX

config OMAP1_MBOX
       tristate "OMAP1 Mailbox framework support"
       depends on ARCH_OMAP1
       help
         Mailbox implementation for OMAP chips with hardware for
         interprocessor communication involving DSP in OMAP1. Say Y here
         if you want to use OMAP1 Mailbox framework support.

config OMAP2PLUS_MBOX
       tristate "OMAP2+ Mailbox framework support"
       depends on ARCH_OMAP2PLUS
       help
         Mailbox implementation for OMAP family chips with hardware for
         interprocessor communication involving DSP, IVA1.0 and IVA2 in
         OMAP2/3; or IPU, IVA HD and DSP in OMAP4. Say Y here if you want
         to use OMAP2+ Mailbox framework support.


config MBOX_KFIFO_SIZE
       int "Mailbox kfifo default buffer size (bytes)"
       default 256
       help
         Specify the default size of mailbox's kfifo buffers (bytes).
         This can also be changed at runtime (via the mbox_kfifo_size
         module parameter).

endif
```

## drivers/media/video/dmm/Kconfig
```kconfig
config DMM_OMAP
	tristate "OMAP DMM support"
	default y
	depends on TILER_OMAP
	help
           DMM driver for OMAP based boards.
```

## drivers/media/video/isp/Kconfig
```kconfig
# Kconfig for OMAP3 ISP driver

config VIDEO_OMAP34XX_ISP_PREVIEWER
	tristate "OMAP ISP Previewer"
	depends on !ARCH_OMAP3410 && VIDEO_OMAP3

config VIDEO_OMAP34XX_ISP_RESIZER
	tristate "OMAP ISP Resizer"
	depends on !ARCH_OMAP3410 && VIDEO_OMAP3

config VIDEO_OMAP34XX_ISP_PREV2RESZ
	tristate "OMAP ISP Preview and Resizer"
	depends on !ARCH_OMAP3410 && VIDEO_OMAP3

config VIDEO_OMAP34XX_ISP_DEBUG_FS
	tristate "OMAP ISP debug file system support"
	depends on VIDEO_OMAP3 && DEBUG_FS
```
