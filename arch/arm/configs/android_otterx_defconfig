## drivers/media/video/omap/Kconfig
```kconfig
config VIDEO_OMAP2_VOUT
	tristate "OMAP2/OMAP3/OMAP4 V4L2-Display driver"
	depends on ARCH_OMAP2 || ARCH_OMAP3 || ARCH_OMAP4
	select VIDEOBUF_GEN
	select VIDEOBUF_DMA_CONTIG if ARCH_OMAP4
	select VIDEOBUF_DMA_SG if ARCH_OMAP3
	select OMAP2_DSS
	select OMAP2_VRAM
	default n
	---help---
	  V4L2 Display driver support for OMAP2/3/4 based boards.

config OMAP2_VRFB
	bool
	depends on ARCH_OMAP2 || ARCH_OMAP3
	default y if VIDEO_OMAP2_VOUT
	help
	  VRFB used in V4L2 in OMAP2,3

config OMAP3_ISP_RESIZER_ON_OVERLAY
	bool "ISP resizer used in V4L2 in OMAP3 (EXPERIMENTAL)"
	depends on EXPERIMENTAL && VIDEO_OMAP34XX_ISP_RESIZER
	default n
	help
	  Use ISP resizer on overlay instead of DSS resizer.
	  Could increase performance of playing 720p clip but,
	  have some issues when record 720p with camera.
```

## drivers/media/video/omapdce/Kconfig
```kconfig
config VIDEO_OMAP_DCE
	tristate "OMAP Distributed Codec Engine"
	select OMAP_RPMSG
	default n
	help
	  Plugin for OMAP to support hw accellerated video
	  decoders/encoders
```

## drivers/media/video/tiler/Kconfig
```kconfig
config TILER_OMAP
	tristate "OMAP TILER support"
	default y
	depends on ARCH_OMAP4
	help
           TILER driver for OMAP based boards.
```

## drivers/misc/bma250/Kconfig
```kconfig
#
# Miscellaneous I2C chip drivers configuration
#

menu "Miscellaneous I2C Chip support"

config BOSCH_BMA250
	tristate "BMA250 acceleration sensor support"
	depends on I2C=y
	default y
	help
	  If you say yes here you get support for Bosch Sensortec's 
	  acceleration sensors BMA250.


if BOSCH_BMA250

config BOSCH_BMA250_INT
	bool "BMA250 interrupt mode"
	help
	  Say Y here, if you wanna use the interrupt mode rather than the polling mode.

endif # STK_OPTICAL_SENSOR
endmenu
```

## drivers/misc/cache-2dmanager/Kconfig
```kconfig
config CACHE2DMANAGER
	tristate "2D Cache operation driver"
	default y
	help
           Enable 2D Cache operation support
```

## drivers/misc/gc-core/Kconfig
```kconfig
config GC_CORE
	tristate "Vivante 2D/3D Core Driver"
	default n
	help
           Vivante 2D/3D Core Driver.
```

## drivers/misc/gcx/gcbv/Kconfig
```kconfig
config GCBV
	tristate "Vivante BLTsville library"
	default y
	depends on GCCORE
	help
           Vivante BLTsville library.
```

## drivers/misc/gcx/gccore/Kconfig
```kconfig
config GCCORE
	tristate "Vivante Core Driver"
	default y
	help
           Vivante Core Driver.
```

## drivers/misc/gcx/gcioctl/Kconfig
```kconfig
config GCIOCTL
	tristate "User interface to Vivante 2D/3D driver"
	default y
	depends on GCCORE
	help
           User interface to Vivante 2D/3D driver.
```
