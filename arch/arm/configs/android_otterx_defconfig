## arch/arm/mach-omap2/Kconfig
```kconfig
if ARCH_OMAP2PLUS

menu "TI OMAP2/3/4 Specific Features"

config ARCH_OMAP2PLUS_TYPICAL
	bool "Typical OMAP configuration"
	default y
	select AEABI
	select REGULATOR
	select PM
	select PM_RUNTIME
	select VFP
	select NEON if ARCH_OMAP3 || ARCH_OMAP4
	select SERIAL_OMAP
	select SERIAL_OMAP_CONSOLE
	select I2C
	select I2C_OMAP
	select MFD_SUPPORT
	select MENELAUS if ARCH_OMAP2
	select TWL4030_CORE if ARCH_OMAP3 || ARCH_OMAP4
	select TWL4030_POWER if ARCH_OMAP3 || ARCH_OMAP4
	help
	  Compile a kernel suitable for booting most boards

config ARCH_OMAP2
	bool "TI OMAP2"
	depends on ARCH_OMAP2PLUS
	default y
	select CPU_V6

config ARCH_OMAP3
	bool "TI OMAP3"
	depends on ARCH_OMAP2PLUS
	default y
	select CPU_V7
	select USB_ARCH_HAS_EHCI
	select ARM_L1_CACHE_SHIFT_6 if !ARCH_OMAP4
	select ARCH_HAS_OPP
	select PM_OPP if PM

config ARCH_OMAP4
	bool "TI OMAP4"
	default y
	depends on ARCH_OMAP2PLUS
	select CPU_V7
	select ARM_GIC
	select LOCAL_TIMERS if SMP
	select PL310_ERRATA_588369 if CONFIG_CACHE_L2X0
	select PL310_ERRATA_727915 if CONFIG_CACHE_L2X0
	select ARM_ERRATA_720789
	select ARCH_HAS_OPP
	select PM_OPP if PM
	select USB_ARCH_HAS_EHCI
	select ARCH_HAS_BARRIERS

comment "OMAP Core Type"
	depends on ARCH_OMAP2

config SOC_OMAP2420
	bool "OMAP2420 support"
	depends on ARCH_OMAP2
	default y
	select OMAP_DM_TIMER
	select ARCH_OMAP_OTG

config SOC_OMAP2430
	bool "OMAP2430 support"
	depends on ARCH_OMAP2
	default y
	select ARCH_OMAP_OTG

config SOC_OMAP3430
	bool "OMAP3430 support"
	depends on ARCH_OMAP3
	default y
	select ARCH_OMAP_OTG

config SOC_OMAPTI816X
	bool "TI816X support"
	depends on ARCH_OMAP3
	default y

config OMAP_PACKAGE_ZAF
       bool

config OMAP_PACKAGE_ZAC
       bool

config OMAP_PACKAGE_CBC
       bool

config OMAP_PACKAGE_CBB
       bool

config OMAP_PACKAGE_CUS
       bool

config OMAP_PACKAGE_CBP
       bool

config OMAP_PACKAGE_CBL
       bool

config OMAP_PACKAGE_CBS
       bool

comment "OMAP Board Type"
	depends on ARCH_OMAP2PLUS

config MACH_OMAP_GENERIC
	bool "Generic OMAP board"
	depends on ARCH_OMAP2
	default y

config MACH_OMAP2_TUSB6010
	bool
	depends on ARCH_OMAP2 && SOC_OMAP2420
	default y if MACH_NOKIA_N8X0

config MACH_OMAP_H4
	bool "OMAP 2420 H4 board"
	depends on SOC_OMAP2420
	default y
	select OMAP_PACKAGE_ZAF
	select OMAP_DEBUG_DEVICES

config MACH_OMAP_APOLLON
	bool "OMAP 2420 Apollon board"
	depends on SOC_OMAP2420
	default y
	select OMAP_PACKAGE_ZAC

config MACH_OMAP_2430SDP
	bool "OMAP 2430 SDP board"
	depends on SOC_OMAP2430
	default y
	select OMAP_PACKAGE_ZAC

config MACH_OMAP3_BEAGLE
	bool "OMAP3 BEAGLE board"
	depends on ARCH_OMAP3
	default y
	select OMAP_PACKAGE_CBB

config MACH_DEVKIT8000
	bool "DEVKIT8000 board"
	depends on ARCH_OMAP3
	default y
	select OMAP_PACKAGE_CUS

config MACH_OMAP_LDP
	bool "OMAP3 LDP board"
	depends on ARCH_OMAP3
	default y
	select OMAP_PACKAGE_CBB

config MACH_OMAP3530_LV_SOM
	bool "OMAP3 Logic 3530 LV SOM board"
	depends on ARCH_OMAP3
	select OMAP_PACKAGE_CBB
	default y
	help
	 Support for the LogicPD OMAP3530 SOM Development kit
	 for full description please see the products webpage at
	 http://www.logicpd.com/products/development-kits/texas-instruments-zoom%E2%84%A2-omap35x-development-kit

config MACH_OMAP3_TORPEDO
	bool "OMAP3 Logic 35x Torpedo board"
	depends on ARCH_OMAP3
	select OMAP_PACKAGE_CBB
	default y
	help
	 Support for the LogicPD OMAP35x Torpedo Development kit
	 for full description please see the products webpage at
	 http://www.logicpd.com/products/development-kits/zoom-omap35x-torpedo-development-kit

config MACH_OVERO
	bool "Gumstix Overo board"
	depends on ARCH_OMAP3
	default y
	select OMAP_PACKAGE_CBB

config MACH_OMAP3EVM
	bool "OMAP 3530 EVM board"
	depends on ARCH_OMAP3
	default y
	select OMAP_PACKAGE_CBB

config FORCE_SILICON_PERFORMANCE
	bool "Force SILICON_TYPE_PERFORMANCE setting (1.2Ghz)"
	depends on MACH_OMAP_4430_KC1
	default N
	help
	  Enables the SILICON_TYPE_PERFORMANCE flag for CPU settings.  This puts the OMAP4430's max at 1.2Ghz.

config WIFI_CONTROL_FUNC
	bool "Enable WiFi control function abstraction"
	depends on MACH_OMAP_4430_KC1 || MACH_OMAP_4430SDP || MACH_OMAP_ZOOM2 || MACH_OMAP_ZOOM3
	select WIRELESS_EXT
	select WEXT_CORE
	select WEXT_PROC
	select WEXT_PRIV
	default Y
	help
	  Enables Power/Reset/Carddetect function abstraction

config MACH_OMAP3517EVM
	bool "OMAP3517/ AM3517 EVM board"
	depends on ARCH_OMAP3
	default y
	select OMAP_PACKAGE_CBB

config MACH_CRANEBOARD
	bool "AM3517/05 CRANE board"
	depends on ARCH_OMAP3
	select OMAP_PACKAGE_CBB

config MACH_OMAP3_PANDORA
	bool "OMAP3 Pandora"
	depends on ARCH_OMAP3
	default y
	select OMAP_PACKAGE_CBB
	select REGULATOR_FIXED_VOLTAGE

config MACH_OMAP3_TOUCHBOOK
	bool "OMAP3 Touch Book"
	depends on ARCH_OMAP3
	default y
	select BACKLIGHT_CLASS_DEVICE

config MACH_OMAP_3430SDP
	bool "OMAP 3430 SDP board"
	depends on ARCH_OMAP3
	default y
	select OMAP_PACKAGE_CBB

config MACH_NOKIA_N800
       bool

config MACH_NOKIA_N810
       bool

config MACH_NOKIA_N810_WIMAX
       bool

config MACH_NOKIA_N8X0
	bool "Nokia N800/N810"
	depends on SOC_OMAP2420
	default y
	select OMAP_PACKAGE_ZAC
	select MACH_NOKIA_N800
	select MACH_NOKIA_N810
	select MACH_NOKIA_N810_WIMAX

config MACH_NOKIA_RM680
	bool "Nokia RM-680 board"
	depends on ARCH_OMAP3
	default y
	select OMAP_PACKAGE_CBB

config MACH_NOKIA_RX51
	bool "Nokia RX-51 board"
	depends on ARCH_OMAP3
	default y
	select OMAP_PACKAGE_CBB

config MACH_OMAP_ZOOM2
	bool "OMAP3 Zoom2 board"
	depends on ARCH_OMAP3
	default y
	select OMAP_PACKAGE_CBB
	select SERIAL_8250
	select SERIAL_CORE_CONSOLE
	select SERIAL_8250_CONSOLE
	select REGULATOR_FIXED_VOLTAGE

config MACH_OMAP_ZOOM3
	bool "OMAP3630 Zoom3 board"
	depends on ARCH_OMAP3
	default y
	select OMAP_PACKAGE_CBP
	select SERIAL_8250
	select SERIAL_CORE_CONSOLE
	select SERIAL_8250_CONSOLE
	select REGULATOR_FIXED_VOLTAGE

config MACH_CM_T35
	bool "CompuLab CM-T35 module"
	depends on ARCH_OMAP3
	default y
	select OMAP_PACKAGE_CUS

config MACH_CM_T3517
	bool "CompuLab CM-T3517 module"
	depends on ARCH_OMAP3
	default y
	select OMAP_PACKAGE_CBB

config MACH_IGEP0020
	bool "IGEP v2 board"
	depends on ARCH_OMAP3
	default y
	select OMAP_PACKAGE_CBB

config MACH_IGEP0030
	bool "IGEP OMAP3 module"
	depends on ARCH_OMAP3
	default y
	select OMAP_PACKAGE_CBB
	select MACH_IGEP0020

config MACH_SBC3530
	bool "OMAP3 SBC STALKER board"
	depends on ARCH_OMAP3
	default y
	select OMAP_PACKAGE_CUS

config MACH_OMAP_3630SDP
	bool "OMAP3630 SDP board"
	depends on ARCH_OMAP3
	default y
	select OMAP_PACKAGE_CBP

config MACH_TI8168EVM
	bool "TI8168 Evaluation Module"
	depends on SOC_OMAPTI816X
	default y

config MACH_OMAP_4430SDP
	bool "OMAP 4430 SDP board"
	default y
	depends on ARCH_OMAP4
	select LEDS_OMAP4430_SDP_DISPLAY
	select LEDS_OMAP4430_SDP_KEYPAD
	select SENSORS_LM75
	select INPUT_BH1780
	select INPUT_BMP085
	select INPUT_HMC5843
	select INPUT_SFH7741
	select INPUT_MISC
	select HWMON
	select INPUT_CMA3000
	select INPUT_CMA3000_I2C
	select OMAP_PACKAGE_CBL
	select OMAP_PACKAGE_CBS
	select REGULATOR_FIXED_VOLTAGE
	select OMAP_TPS6236X
	select TOUCHSCREEN_SYNTM12XX
	select TWL6030_POWEROFF
	select INPUT_TWL6030_PWRBUTTON
	select TWL6040_VIB
	select TWL6030_BCI_BATTERY
	select CHARGER_BQ2415x
	select TWL6030_GPADC
	select OMAP_REBOOT_REASON
	select OMAP_RAM_CONSOLE
	select CDC_TCXO
	select OMAP_RFKILL_STE_MODEM

config MACH_OMAP_BLAZE
	bool "OMAP 44xx Tablet2 Board"
	default y
	depends on ARCH_OMAP4
	select OMAP_PACKAGE_CBL
	select OMAP_PACKAGE_CBS
	select TOUCHSCREEN_QUANTUM_OBP
	select TOUCHSCREEN_CYPRESS_TTSP
	select LEDS_OMAP4430_SDP_DISPLAY
	select LEDS_OMAP4430_SDP_KEYPAD
	select INPUT_TSL2771
	select INPUT_BMP085
	select INPUT_HMC5843
	select INPUT_MPU3050
	select INPUT_BMA180
	select PANEL_TC358765
	select KEYBOARD_GPIO
	select TWL6040_VIB
	select OMAP_REBOOT_REASON
	select OMAP_RAM_CONSOLE
	select CDC_TCXO

config MACH_OMAP_4430_KC1
	bool "OMAP 4430 KC1 board"
	depends on ARCH_OMAP4
	select OMAP_PACKAGE_CBL
	select OMAP_PACKAGE_CBS
	select INPUT_MISC
	select INPUT_TOUCHSCREEN
	select NEW_LEDS
	select LEDS_CLASS
	select MISC_DEVICES
	select HWMON
	select POWER_SUPPLY
	select TWL6030_POWEROFF
	select TWL6030_GPADC
	select OMAP_REBOOT_REASON
	select REGULATOR_FIXED_VOLTAGE

config MACH_OMAP4_PANDA
	bool "OMAP4 Panda Board"
	default y
	depends on ARCH_OMAP4
	select OMAP_PACKAGE_CBL
	select OMAP_PACKAGE_CBS
	select REGULATOR_FIXED_VOLTAGE
	select OMAP_TPS6236X
	select OMAP_REBOOT_REASON
	select OMAP_RAM_CONSOLE

config OMAP3_EMU
	bool "OMAP3 debugging peripherals"
	depends on ARCH_OMAP3
	select ARM_AMBA
	select OC_ETM
	help
	  Say Y here to enable debugging hardware of omap3

config OMAP3_SDRC_AC_TIMING
	bool "Enable SDRC AC timing register changes"
	depends on ARCH_OMAP3
	default n
	help
	  If you know that none of your system initiators will attempt to
	  access SDRAM during CORE DVFS, select Y here.  This should boost
	  SDRAM performance at lower CORE OPPs.  There are relatively few
	  users who will wish to say yes at this point - almost everyone will
	  wish to say no.  Selecting yes without understanding what is
	  going on could result in system crashes;

config OMAP_TPS6236X
       bool

config OMAP_ALLOW_OSWR
	bool  "Enable Open Switch Retention"
	depends on ARCH_OMAP4
	default n
	help
	  Select this option to enable OSWR support.
	  Which means the Logic of power domains can be lost now
	  unlike the CSWR wherein the logic is retained

config OMAP_FIQ_DEBUGGER
	bool "Enable the serial FIQ debugger on OMAP"
	default y
	select FIQ_DEBUGGER
	help
	  Enables the serial FIQ debugger on OMAP"

config OMAP_REBOOT_REASON
	depends on ARCH_OMAP4
	bool

config OMAP4_DPLL_CASCADING
       bool  "Enable DPLL Cascading for OMAP4"
       depends on ARCH_OMAP4
       depends on PM
       depends on HAS_EARLYSUSPEND
       default y
       help
         Select this option to enable DPLL Cascading during Low power mp3
         playback. It will enter DPLL cascade when :
               - Head set is inserted.
               - Display is Off.
               - No USB.

config OMAP4_ONLY_OMAP4430_DPLL_CASCADING
       bool  "Enable DPLL Cascading for OMAP4430 only"
       depends on OMAP4_DPLL_CASCADING
       default y
       help
         Enables DPLL Cascading only for OMAP4430.
	 Current DPLL cascading implementation is going to be used
	 only on OMAP4430, where it provides significant power savings.
	 Keeps DPLL cascading disabled for other OMAPs.

config OMAP_RAM_CONSOLE
        bool "Enable OMAP support for Android RAM console"
        depends on ANDROID_RAM_CONSOLE
        help
          Select this option to enable Android RAM console support on OMAP.
          This allows saving the kernel printk messages to a buffer in RAM, so
          that after a kernel panic they can be viewed in the next kernel
          invocation, by accessing /proc/last_kmsg
          NOTE: Board file needs to invoke relevant api to enable the support

config OMAP4_PPA_CPU1_ONLINE_BUG
	bool "Enable Support for CPU1 ONLINE WA for OSWR/OFF"
	depends on ARCH_OMAP4
	depends on OMAP_ALLOW_OSWR
	default y
	help
	  If an non GP OMAP4 device is used and PPA revision is < v1.7.3,
	  the device does not perform the memory maintenance and TLB sync
	  operations required before releasing CPU1 to HLOS. This results
	  in crash while resuming from OFF mode.

	  Disable this option *ONLY IF* you meet the minimum PPA version
	  requirement.

	  If, on the other hand, you do not understand the change, leave the
	  default as enabled.

config OMAP4_ARM_ERRATA_742230
	bool "Enables the workaround for ARM errata 742230 on GP devices"
	default y
	help
	  Enables the ARM errata 742230 on OMAP443x and OMAP446x (GP) devices.
	  This involves setting bit 4 of the CP15 diagnostic control register.
	  This is handled for HS devices in the PPA code and does not need to be
	  enabled."

config OMAP4_ARM_ERRATA_751472
	bool "Enables the workaround for ARM errata 751472 on GP devices"
	default y
	help
	  Enables the ARM errata 751472 on OMAP443x and OMAP446x (GP) devices.
	  This involves setting bit 11 of the CP15 diagnostic control register.
	  This is handled for HS devices in the PPA code and does not need to be
	  enabled."

config OMAP4_ARM_ERRATA_743622
	bool "Enabled the workaround for ARM errata 743622 on GP devices"
	default y
	help
	  Enables the workaround for ARM errata 743622 on OMAP4.
	  This involves setting bit 6 of the CP15 diagnostic control register.
	  This is handled for HS devices in the PPA code and does not need to be
	  enabled."

config OMAP4_HSOTG_ED_CORRECTION
	bool "OMAP 44XX HSOTG Eye diagram correction"
	depends on ARCH_OMAP4
	default y
	help
	  Select this option to overrive HSOTG PHY settings in
	  order to improve Eye Diagramm. On 4430 CPUs this should
	  improve Eye Diagram at least 8%.

config OMAP_RFKILL_STE_MODEM
	bool "Enable OMAP RFKILL driver for ST-E modem"
	depends on RFKILL || !RFKILL
	help
	  Select this option to enable usage of RFKILL driver for ST-E modem on
	  OMAP platforms. This will permit control of power on and off sequences
	  of the modem as well as necessary dynamic pin muxing of AP/CP
	  interfaces (platform data dependant)

endmenu

endif
```
