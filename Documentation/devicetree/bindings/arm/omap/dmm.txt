## Documentation/devicetree/bindings/arm/omap/dmm.txt
```
OMAP Dynamic Memory Manager (DMM) bindings

Required properties:
- compatible:   Must be "ti,omap4-dmm" for OMAP4 family
		Must be "ti,omap5-dmm" for OMAP5 family
- reg:         Contains timer register address range (base address and length)
- interrupts:  Contains interrupt information (source, etc) for the DMM IRQ
- ti,hwmods:   Name of the hwmod associated to the counter, which is typically
		"dmm"

Example:

dmm: dmm@4e000000 {
	compatible = "ti,omap4-dmm";
	reg = <0x4e000000 0x800>;
	ti,hwmods = "dmm";
};
```

## Documentation/devicetree/bindings/arm/omap/timer.txt
```
OMAP Timer bindings

Required properties:
- compatible:		Must be "ti,omap2-timer" for OMAP2+ controllers.
- reg:			Contains timer register address range (base address and
			length).
- interrupts: 		Contains the interrupt information for the timer. The
			format is being dependent on which interrupt controller
			the OMAP device uses.
- ti,hwmods:		Name of the hwmod associated to the timer, "timer<X>",
			where <X> is the instance number of the timer from the
			HW spec.

Optional properties:
- ti,timer-alwon:	Indicates the timer is in an alway-on power domain.
- ti,timer-dsp:		Indicates the timer can interrupt the on-chip DSP in
			addition to the ARM CPU.
- ti,timer-ipu:		Indicates the timer can interrupt the on-chip IPU (the
			dual Cortex-M3/Cortex-M4 subsystem on OMAP4/OMAP5) in
			addition to the ARM CPU.
- ti,timer-pwm: 	Indicates the timer can generate a PWM output.
- ti,timer-secure: 	Indicates the timer is reserved on a secure OMAP device
			and therefore cannot be used by the kernel.
- ti,timer-non-wkup	Indicates the timer is in non-wkup power domain and hence
			will lose register context when the power domain transitions

Example:

timer12: timer@48304000 {
	compatible = "ti,omap2-timer";
	reg = <0x48304000 0x400>;
	interrupts = <95>;
	ti,hwmods = "timer12"
	ti,timer-alwon;
	ti,timer-secure;
};
```

## Documentation/devicetree/bindings/clock/omap-clock.txt
```
Device Tree Clock bindings for Texas Instrument's OMAP compatible platforms

This binding is an initial minimal binding that may be enhanced as part of
transitioning OMAP clock data out of kernel image.

This binding uses the common clock binding[1].

[1] Documentation/devicetree/bindings/clock/clock-bindings.txt

Required properties:
- compatible : shall be "ti,omap-clock"
- #clock-cells : from common clock binding; shall be set to 0.
NOTE:
node name should map to clock database in arch/arm/mach-omap2/cclock<SoC>_data.c
Since all clocks are described with _ck, the node name is optimized to drop the
usage of _ck. For example, a clock called dpll1_ck will be defined as dpll1.

Example #1: describing clock node for CPU on OMAP34xx platform:
Ref: arch/arm/mach-omap2/cclock3xxx_data.c
describes the CPU clock to be as follows
	CLK(NULL,	"dpll1_ck",	&dpll1_ck,	CK_3XXX),
Corresponding binding will be:
	dpll1: dpll1 {
		#clock-cells = <0>;
		compatible = "ti,omap-clock";
	};
And it's usage will be:
		clocks = <&dpll1>;

Example #2: describing clock node for auxilary clock #3 on OMAP443x platform:
Ref: arch/arm/mach-omap2/cclock44xx_data.c
describes the auxclk3 clock to be as follows:
	CLK(NULL,	"auxclk3_ck",	&auxclk3_ck,	CK_443X),
Corresponding binding will be:
	auxclk3: auxclk3 {
		#clock-cells = <0>;
		compatible = "ti,omap-clock";
	};
And it's usage will be:
	clocks = <&auxclk3>;
```

## Documentation/devicetree/bindings/clock/palmas-clk.txt
```
* palmas and palmas-charger resource clock IP block devicetree bindings

Required properties:
- compatible : Should be from the list
  ti,twl6035-clk
  ti,twl6036-clk
  ti,twl6037-clk
  ti,tps65913-clk
  ti,tps65914-clk
  ti,tps80036-clk
and also the generic series names
  ti,palmas-clk

Optional properties:
- ti,clk32g-mode-sleep		- mode to adopt in pmic sleep 0 - off, 1 - on
- ti,clkg32kgaudio-mode-sleep	- see above

Example:

clk {
    compatible = "ti,twl6035-clk", "ti,palmas-clk";
    ti,clk32kg-mode-sleep = <0>;
    ti,clk32kgaudio-mode-sleep = <0>;
    #clock-cells = <1>;
    clock-frequency = <32000000>;
    clock-names = "clk32kg", "clk32kgaudio";
};
```

## Documentation/devicetree/bindings/clock/ti-clock-alias.txt
```
* Clock alias provision for TI OMAP2+ boards

This binding allows the board's device tree file to specify a clock name,
device phandle and clock alias so that that clock can be associated
to the device with the alias.

This is required in cases where an external device is clocked by an
OMAP generated clock and needs to be assocated to it.

NOTE: The node's name should be clock_alias

Required properties
- clock-name: The clock identifier string. Should be one of the
  clock ids defined in OMAP common clock data.
- clock-alias: A string specifying the alias that must be created to the clock.
- device: A phandle to the device this clock should be associated to.

e.g. On the OMAP4 Panda board, the USB PHY device is clocked by the
FREF_CLK3 (auxclk3_ck) from the OMAP. The PHY driver expexts the clock to
be named "main_clk". This binding can be provided like so

clock_alias {
	clock-name = "auxclk3_ck";
	clock-alias = "main_clk";
	device = <&hsusb1_phy>;
};
```

## Documentation/devicetree/bindings/gpio/gpio-palmas.txt
```
* palmas and palmas charger GPIO IP block devicetree bindings

Required properties:
- compatible : Should be from the list
  ti,twl6035-gpio
  ti,twl6036-gpio
  ti,twl6037-gpio
  ti,tps65913-gpio
  ti,tps65914-gpio
  ti,tps80036-gpio

and also the generic series names

  ti,palmas-gpio

- gpio-controller: mark the device as a GPIO controller
- gpio-cells = <1>:  GPIO lines are provided.
- interrupt-controller : palmas has its own internal IRQs
- #interrupt-cells : should be set to 2 for IRQ number and flags
  The first cell is the IRQ number.
  The second cell is the flags, encoded as the trigger masks from
  Documentation/devicetree/bindings/interrupts.txt
- interrupt-parent : The parent interrupt controller.

Example:

gpio {
    compatible = "ti,twl6035-gpio", "ti,palmas-gpio";

    gpio-controller;
    #gpio-cells = <1>;
    interrupt-parent = <&palmas>;
    interrupt-controller;
    #interrupt-cells = <2>;
};
```

## Documentation/devicetree/bindings/input/palmas-pwrbutton.txt
```
* palmas and palmas-charger Button IP block devicetree bindings

Required properties:
- compatible : Should be from the list
  ti,twl6035-pwrbutton
  ti,twl6036-pwrbutton
  ti,twl6037-pwrbutton
  ti,tps65913-pwrbutton
  ti,tps65914-pwrbutton
  ti,tps80036-pwrbutton
and also the generic series names
  ti,palmas-pwrbutton

- interrupts: the interrupt outputs of the controller.
- interrupt-names : Should be the name of irq resource. Each interrupt
  binds its interrupt-name.
- interrupt-parent : The parent interrupt controller.

Example:

pwrbutton {
    compatible = "ti,twl6035-pwrbutton", "ti,palmas-pwrbutton";
    interrupt-parent = <&palmas>;
    interrupts = <1 0>;
    interrupt-names = "pwron-irq";
};
```

## Documentation/devicetree/bindings/leds/leds-palmas.txt
```
* palmas and palmas-charger LED IP block devicetree bindings

Required properties:
- compatible : Should be from the list
  ti,twl6035-leds
  ti,twl6036-leds
  ti,twl6037-leds
  ti,tps65913-leds
  ti,tps65914-leds
  ti,tps80036-leds
and also the generic series names
  ti,palmas-leds

Optional properties:
-ti,led1-current	- sink current setting 0 - 0mA, 1 - 25mA, 2 - 5mA,
				3 - 0mA, 4 - 5mA, 5 - 5mA, 6 - 10.0mA, 7 - 0mA
-ti,led2-current	- see above
-ti,led3-current	- see above
-ti,led4-current	- see above
-ti,chrg-led-mode	- only valid for charger - mode for charging led operation
				0 - Charging indicator
				1 - controlled as a general purpose LED
-ti,chrg-led-vbat-low	- only valid for charger - blinking of low battery led
				0 - blinking is enabled,
				1 - blinking is disabled

Example:
leds {
	compatible = "ti,twl6035-leds", "ti,palmas-leds";
	ti,led1-current = <0>;
	ti,led2-current = <0>;
	ti,led3-current = <0>;
	ti,led4-current = <0>;
	ti,chrg-led-mode = <0>;
	ti,chrg-led-vbat-low = <0>;
};
```

## Documentation/devicetree/bindings/mailbox/omap-mailbox.txt
```
OMAP2+ Mailbox Driver

Required properties:
- compatible:		Should be one of the following,
			    "ti,omap2-mailbox" for
				OMAP2420, OMAP2430, OMAP3430, OMAP3630 SoCs
			    "ti,omap4-mailbox" for
				OMAP44xx, OMAP54xx, AM33xx, AM43xx, DRA7xx SoCs
- reg:			Contains the mailbox register address range (base
			address and length)
- interrupts: 		Contains the interrupt information for the mailbox
			device. The format is dependent on which interrupt
			controller the OMAP device uses
- ti,hwmods:		Name of the hwmod associated with the mailbox
- ti,mbox-num-users:	Number of targets (processor devices) that the mailbox device
			can interrupt
- ti,mbox-num-fifos:	Number of h/w fifos within the mailbox device
- #ti,mbox-data-cells:	Cell size for describing a mailbox
			(currently should be 4)
- ti,mbox-names:	Array of the names of the mailboxes
- ti,mbox-data:		Mailbox descriptor data private to each mailbox. The 4
			cells represent the following data,
			  Cell #1 (tx_id) - mailbox fifo id used for
						transmitting messages
			  Cell #2 (rx_id) - mailbox fifo id on which messages
						are received
			  Cell #3 (irq_id) - irq identifier index number to use
						from the interrupts data
			  Cell #4 (usr_id) - mailbox user id for identifying the
						interrupt into the MPU interrupt
						controller.

Example:

/* OMAP4 */
mailbox: mailbox@4a0f4000 {
	compatible = "ti,omap4-mailbox";
	reg = <0x4a0f4000 0x200>;
	interrupts = <0 26 0x4>;
	ti,hwmods = "mailbox";
	ti,mbox-num-users = <3>;
	ti,mbox-num-fifos = <8>;
	#ti,mbox-data-cells = <4>
	ti,mbox-names = "mbox-ipu", "mbox-dsp";
	ti,mbox-data = <0 1 0 0>, <3 2 0 0>;
};
```

## Documentation/devicetree/bindings/media/dra7-radio.txt
```
Texas Instruments DRA7xx Radio Helper

Radio Helper is a dummy device on top of the devices such as McAsp
that needs to be configured for Radio playback.
The corresponding platform driver configures these devices as
required.

Top node:
Required properties:
- compatible: "ti,dra7xx_radio"
- gpios:  list of the gpios that needs to be configured

child nodes:
- compatible: "ti,dra7xx_radio_subdev"
- ti,hwmods: Name of the hwmod associated to the underlying devices
- status: Device status
```

## Documentation/devicetree/bindings/mfd/omap_control.txt
```
* Texas Instrument OMAP System Control Module (SCM) bindings

The control module allows software control of various static modes supported by
the device. The control module controls the settings of various device  modules
through register configuration and internal signals. It also controls  the  pad
configuration, pin functional multiplexing, and the routing of internal signals
(such as PRCM  signals or DMA requests)  to output pins configured for hardware
observability.

Required properties:
- compatible : Should be:
  - "ti,omap3-control" for OMAP3 support
  - "ti,omap4-control" for OMAP4 support
  - "ti,omap5-control" for OMAP5 support

OMAP specific properties:
- ti,hwmods: Name of the hwmod associated to the control module:
  Should be "ctrl_module_core";

Sub-nodes:
- bandgap : contains the bandgap node

  The bindings details of individual bandgap device can be found in:
  Documentation/devicetree/bindings/thermal/omap_bandgap.txt

- usb : contains the usb phy pin control node

  The only required property for this child is:
    - compatible = "ti,omap4-control-usb";

Examples:

ctrl_module_core: ctrl_module_core@4a002000 {
	compatible = "ti,omap4-control";
	ti,hwmods = "ctrl_module_core";
	bandgap {
		compatible = "ti,omap4460-bandgap";
		interrupts = <0 126 4>; /* talert */
		ti,tshut-gpio = <86>; /* tshut */
	};
	usb {
		compatible = "ti,omap4-usb-phy";
	};
};
```

## Documentation/devicetree/bindings/mfd/palmas.txt
```
* palmas and palmas-charger device tree bindings

The TI palmas family current members :-
twl6035 (palmas)
twl6036 (palmas-charger)
twl6037 (palmas)
tps65913 (palmas)
tps65914 (palmas)
tps80036 (palmas-charger)

Required properties:
- compatible : Should be from the list
  ti,twl6035
  ti,twl6036
  ti,twl6037
  ti,tps65913
  ti,tps65914
  ti,tps80036
  ti,tps659038
and also the generic series names
  ti,palmas
  ti,palmas-charger
- interrupt-controller : palmas has its own internal IRQs
- #interrupt-cells : should be set to 2 for IRQ number and flags
  The first cell is the IRQ number.
  The second cell is the flags, encoded as the trigger masks from
  Documentation/devicetree/bindings/interrupts.txt
- interrupt-parent : The parent interrupt controller.

Optional properties:
  ti,mux_padX : set the pad register X (1-2) to the correct muxing for the
		hardware, if not set will use muxing in OTP.

Example:

palmas {
	compatible = "ti,twl6035", "ti,palmas";
	reg = <0x48>
	interrupt-parent = <&intc>;
	interrupt-controller;
	#interrupt-cells = <2>;

	ti,mux-pad1 = <0>;
	ti,mux-pad2 = <0>;

	#address-cells = <1>;
	#size-cells = <0>;

	pmic {
		compatible = "ti,twl6035-pmic", "ti,palmas-pmic";
		....
	}

	gpio {
		compatible = "ti,twl6035-gpio", "ti,palmas-gpio";
		....
	};

	wdt {
		compatible = "ti,twl6035-wdt", "ti,palmas-wdt";
		....
	};

	rtc {
		compatible = "ti,twl6035-rtc", "ti,palmas-rtc";
		....
	};

	pwrbutton {
		compatible = "ti,twl6035-pwrbutton", "ti,palmas-pwrbutton";
		....
	};

	leds {
		compatible = "ti,twl6035-leds", "ti-palmas-leds";
	}

	clk {
		compatible = "ti,twl6035-clk", "ti,palmas-clk";
		....
	};
}
```

## Documentation/devicetree/bindings/net/ti-wlxxxx.txt
```
* Texas Instrument WiLink module

Wilink module is a combo wireless connectivity sdio card based on
Texas Instrument's wl18xx solution.
It is a 4-wire, 1.8V, embedded sdio wlan device with an external irq
line and is power-controlled by a gpio-based fixed regulator.

Required properties:
- compatible: "wlcore, kim, btwilink"
- irq : The interrupt number of the out-of-band interrupt line which is connected to the wilink module
- gpio: In case an gpio-irq is used, this field should hold the relevant gpio number.
  Only one of the two (gpio/irq) should be specified, according to the platform
- flow_cntrl: Field to enabl/disable use of flow control
- baud_rate: baud rate to use while using BT uart controller
```
