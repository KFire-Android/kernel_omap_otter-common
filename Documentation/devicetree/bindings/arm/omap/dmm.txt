## Documentation/devicetree/bindings/regulator/palmas-pmic.txt
```
* palmas and palmas-charger regulator IP block devicetree bindings

Required properties:
- compatible : Should be from the list
  ti,twl6035-pmic
  ti,twl6036-pmic
  ti,twl6037-pmic
  ti,tps65913-pmic
  ti,tps65914-pmic
  ti,tps80036-pmic
  ti,tps659038-pmic
and also the generic series names
  ti,palmas-pmic

Optional properties:
- ti,ldo6-vibrator : ldo6 is in vibrator mode

Optional nodes:
- regulators : should contain the constrains and init information for the
	       regulators. It should contain a subnode per regulator from the
	       list.
	       For ti,palmas-pmic - smps12, smps123, smps3 depending on OTP,
	       smps45, smps457, smps7 depending on varient, smps6, smps[8-10],
	       ldo[1-9], ldoln, ldousb
	       For ti,palmas-charger-pmic - smps12, smps123, smps3 depending on OTP,
	       smps[6-9], boost, ldo[1-14], ldoln, ldousb

	       optional chip specific regulator fields :-
	       ti,warm-reset - maintain voltage during warm reset
	       ti,roof-floor - control voltage selection by pin
	       ti,sleep-mode - mode to adopt in pmic sleep 0 - off, 1 - auto,
	       2 - eco, 3 - forced pwm
	       ti,tstep - slope control 0 - Jump, 1 10mV/us, 2 5mV/us, 3 2.5mV/us
	       ti,smps-range - OTP has the wrong range set for the hardware so override
	       0 - low range, 1 - high range

Example:

pmic@0 {
	compatible = "ti,twl6035-pmic", "ti,palmas-pmic";
	interrupt-parent = <&palmas>;
	interrupts = <14 0>;
	interrupt-name = "short-irq";

	ti,ldo6_vibrator;

	regulators {
		smps12_reg : smps12 {
			regulator-name = "smps12";
			regulator-min-microvolt = < 600000>;
			regulator-max-microvolt = <1500000>;
			regulator-always-on;
			regulator-boot-on;
			ti,warm-reset;
			ti,roof-floor;
			ti,mode-sleep = <0>;
			ti,tstep = <0>;
			ti,smps-range = <1>;
		};

		smps3_reg: smps3 {
			regulator-name = "smps3";
			regulator-min-microvolt = < 600000>;
			regulator-max-microvolt = <1310000>;
		};

		smps45_reg: smps45 {
			regulator-name = "smps45";
			regulator-min-microvolt = < 600000>;
			regulator-max-microvolt = <1310000>;
		};

		smps6_reg: smps6 {
			regulator-name = "smps6";
			regulator-min-microvolt = <1200000>;
			regulator-max-microvolt = <1200000>;
		};

		smps7_reg: smps7 {
			regulator-name = "smps7";
			regulator-min-microvolt = <1800000>;
			regulator-max-microvolt = <1800000>;
		};

		smps8_reg: smps8 {
			regulator-name = "smps8";
			regulator-min-microvolt = < 600000>;
			regulator-max-microvolt = <1310000>;
		};

		smps9_reg: smps9 {
			regulator-name = "smps9";
			regulator-min-microvolt = <2100000>;
			regulator-max-microvolt = <2100000>;
		};

		smps10_reg: smps10 {
			regulator-name = "smps10";
			regulator-min-microvolt = <5000000>;
			regulator-max-microvolt = <5000000>;
		};

		ldo1_reg: ldo1 {
			regulator-name = "ldo1";
			regulator-min-microvolt = <2800000>;
			regulator-max-microvolt = <2800000>;
		};

		ldo2_reg: ldo2 {
			regulator-name = "ldo2";
			regulator-min-microvolt = <2900000>;
			regulator-max-microvolt = <2900000>;
		};

		ldo3_reg: ldo3 {
			regulator-name = "ldo3";
			regulator-min-microvolt = <3000000>;
			regulator-max-microvolt = <3000000>;
		};

		ldo4_reg: ldo4 {
			regulator-name = "ldo4";
			regulator-min-microvolt = <2200000>;
			regulator-max-microvolt = <2200000>;
		};

		ldo5_reg: ldo5 {
			regulator-name = "ldo5";
			regulator-min-microvolt = <1800000>;
			regulator-max-microvolt = <1800000>;
		};

		ldo6_reg: ldo6 {
			regulator-name = "ldo6";
			regulator-min-microvolt = <1500000>;
			regulator-max-microvolt = <1500000>;
		};

		ldo7_reg: ldo7 {
			regulator-name = "ldo7";
			regulator-min-microvolt = <1500000>;
			regulator-max-microvolt = <1500000>;
		};

		ldo8_reg: ldo8 {
			regulator-name = "ldo8";
			regulator-min-microvolt = <1500000>;
			regulator-max-microvolt = <1500000>;
		};

		ldo9_reg: ldo9 {
			regulator-name = "ldo9";
			regulator-min-microvolt = <1800000>;
			regulator-max-microvolt = <1800000>;
		};

		ldoln_reg: ldoln {
			regulator-name = "ldoln";
			regulator-min-microvolt = <1800000>;
			regulator-max-microvolt = <1800000>;
		};

		ldousb_reg: ldousb {
			regulator-name = "ldousb";
			regulator-min-microvolt = <3250000>;
			regulator-max-microvolt = <3250000>;
		};
	};
};
```

## Documentation/devicetree/bindings/regulator/ti-avs-class0.txt
```
Texas Instrument SmartReflex AVS Class 0 Regulator

Required properties:
- compatible: "ti,avsclass0"
- reg: Should contain Efuse registers location and length
- avs-supply: The supply for AVS block
- efuse-settings: An array of 2-tuples items, and each item consists
  of Voltage index and efuse offset(from reg) like: <voltage offset>
	voltage: Voltage index in microvolts (also called nominal voltage)
	offset: ofset in bytes from base provided in reg
  NOTE: min_uV, max_uV are pickedup from this list

Optional properties:
- voltage-tolerance: Specify the voltage tolerance in percentage
- ti,avsclass0-microvolt-values: Boolean property indicating that the efuse
  values are in microvolts

Example #1: single rails:
soc.dtsi:
avs_mpu: regulator-avs@0x40200000 {
	compatible = "ti,avsclass0";
	reg = <0x40200000 0x20>;
	efuse-settings = <975000 0
		1075000 4
		1200000 8>;
};

avs_core: regulator-avs@0x40300000 {
	compatible = "ti,avsclass0";
	reg = <0x40300000 0x20>;
	efuse-settings = <975000 0
		1050000 4>;
};

board.dtsi:
&avs_mpu {
		avs-supply = <&vcc>;
};
&avs_core {
		avs-supply = <&smps2>;
};

Example #2: Ganged (combined) rails:
soc.dtsi:
avs_mpu: regulator-avs@0x40200000 {
	compatible = "ti,avsclass0";
	reg = <0x40200000 0x20>;
	efuse-settings = <975000 0
		1075000 4
		1200000 8>;
};

avs_core: regulator-avs@0x40300000 {
	compatible = "ti,avsclass0";
	reg = <0x40300000 0x20>;
	efuse-settings = <975000 0
		1050000 4>;
};

board.dtsi:
&avs_mpu {
		avs-supply = <&smps3>;
};
&avs_core {
		avs-supply = <&smps3>;
};
```

## Documentation/devicetree/bindings/rtc/palmas-rtc.txt
```
* palmas and palmas-charger RTC IP block devicetree bindings

Required properties:
- compatible : Should be from the list
  ti,twl6035-rtc
  ti,twl6036-rtc
  ti,twl6037-rtc
  ti,tps65913-rtc
  ti,tps65914-rtc
  ti,tps80036-rtc
and also the generic series names
  ti,palmas-rtc

Examples:

rtc {
    compatible = "ti,twl6035-rtc", "ti,palmas-rtc";
    interrupt-parent = <&palmas>;
    interrupts = <8 0 9 0>;
    interrupt-name = "alarm-irq", "timer-irq";
};
```

## Documentation/devicetree/bindings/sound/dra7-atl.txt
```
* Texas Instruments DRA7 Audio Tracking Logic (ATL)

Required properties:
- compatible: "ti,dra7-atl"
- ti,hwmods: Name of the hwmod associated with the ATL module


Optional properties:
- ti,atclk<n>-freq: Output clock frequency for ATL instance n.
		ATL instance is disabled if this property is not set
- ti,atl<n>-bws-input: ATL baseband word select input for ATL instance n.
  Possible inputs are:
	 0 - McASP1 FSR
	 1 - McASP1 FSX
	 2 - McASP2 FSR
	 3 - McASP2 FSX
	 4 - McASP3 FSX
	 5 - McASP4 FSX
	 6 - McASP5 FSX
	 7 - McASP6 FSX
	 8 - McASP7 FSX
	 9 - McASP8 FSX
	10 - McASP8 AHCLKX
	11 - XREF_CLK3 input pad
	12 - XREF_CLK0 input pad
	13 - XREF_CLK1 input pad
	14 - XREF_CLK2 input pad
	15 - OSC1_X1 input pad
- ti,atl<n>-aws-input: Audio word select input for ATL instance n.
  Same inputs than BWS.


Example:

atl: atl@0x4843c000 {
	compatible = "ti,dra7-atl";
	reg = <0x4843c000 0x3ff>;
	ti,hwmods = "atl";
	ti,atclk1-freq = <11289600>;	/* 11.2896 MHz */
	ti,atl1-bws-input = <2>;	/* McASP2 FSR */
	ti,atl1-aws-input = <4>;	/* McASP3 FSX */
};
```

## Documentation/devicetree/bindings/sound/dra7-evm.txt
```
* Texas Instruments DRA7 EVM sound

Required properties:
- compatible: "ti,dra7-evm-sound"
- ti,mode: Name of the sound card
- ti,media-cpu: phandle for the McASP node in media link
- ti,media-codec: phandle for the analog codec in media link
- ti,media-mclk-freq: MCLK frequency for the analog codec in media link
- ti,media-slots: Number of slots
- ti,multichannel-cpu: phandle for the McASP node in multichannel link.
  It can be omitted for cpu dailess mode (DSP-based radio).
- ti,multichannel-codec-a: phandle for the analog codec instance A
- ti,multichannel-codec-b: phandle for the analog codec instance B
- ti,multichannel-codec-c: phandle for the analog codec instance C
- ti,multichannel-slots: number of TDM slots
- ti,multichannel-mclk-freq: MCLK frequency for the analog codec
- ti,audio-routing: List of connections between audio components.
  Each entry is a pair of strings, the first being the connection's sink,
  the second being the connection's source.

Optional properties:
- ti,always-on: Keep analog codecs always on to minimize artifacts. Use it
  if power is not a concern.
- ti,bt-cpu: phandle for the McASP node used for bluetooth.
- ti,bt-bclk-freq: Bit clock frequency provided by bluetooth chip.
- gpios: selects/enables the DAI pins (Media, Bluetooth)

Available audio endpoints for the audio-routing table:

Board connectors:
 * Main Mic
 * Line In
 * Headphone
 * Line Out
 * JAMR3 Stereo Aux In
 * JAMR3 Mono Mic 1
 * JAMR3 Mono Mic 2
 * JAMR3 Line Out 1
 * JAMR3 Line Out 2
 * JAMR3 Line Out 3

tlv320aic3x pins:
 * LLOUT
 * RLOUT
 * MONO_LOUT
 * HPLOUT
 * HPROUT
 * HPLCOM
 * HPCOM
 * MIC3L
 * MIC3R
 * LINE1L
 * LINE1R
 * LINE2L
 * LINE2R

JAMR3 analog codec pins for instances A, B and C are prefixed with
'J3A', 'J3B' and 'J3C', respectively.

Example:

sound {
	compatible = "ti,dra7-evm-sound";
	ti,model = "DRA7-EVM";

	/* Media DAI link */
	ti,media-cpu = <&mcasp3>;
	ti,media-codec = <&tlv320aic3106>;
	ti,media-mclk-freq = <1411200>;
	ti,media-slots = <2>;

	/* Multichannel DAI link */
	ti,multichannel-cpu = <&mcasp6>;
	ti,multichannel-codec-a = <&tlv320aic3106a>;
	ti,multichannel-codec-b = <&tlv320aic3106b>;
	ti,multichannel-codec-c = <&tlv320aic3106c>;
	ti,multichannel-slots = <16>;
	ti,multichannel-mclk-freq = <11289600>;

	/* Audio routing */
	ti,audio-routing =
			"LINE1L", "Line In",
			"LINE1R", "Line In",
			"MIC3L", "Main Mic",
			"MIC3R", "Main Mic",
			"Main Mic", "Mic Bias 2V",
			"Headphone", "HPLOUT",
			"Headphone", "HPROUT",
			"Line Out", "LLOUT",
			"Line Out", "RLOUT",
			"J3A LINE1L", "JAMR3 Stereo Aux In",
			"J3A LINE1R", "JAMR3 Stereo Aux In",
			"J3B LINE1L", "JAMR3 Mono Mic 1",
			"J3B LINE1R", "JAMR3 Mono Mic 2",
			"JAMR3 Line Out 1", "J3A LLOUT",
			"JAMR3 Line Out 1", "J3A RLOUT",
			"JAMR3 Line Out 2", "J3B LLOUT",
			"JAMR3 Line Out 2", "J3B RLOUT",
			"JAMR3 Line Out 3", "J3C LLOUT",
			"JAMR3 Line Out 3", "J3C RLOUT";
};
```

## Documentation/devicetree/bindings/sound/omap-abe-core.txt
```
* Texas Instruments OMAP4+ AESS

Required properties:
- compatible: "ti,omap-mcpdm"
- reg: Register location and size as an array:
       <MPU access base address, size>,
       <MPU DMEM access base address, size>,
       <MPU CMEM access base address, size>,
       <MPU SMEM access base address, size>,
       <MPU PMEM access base address, size>,
       <L3 interconnect address, size>;
       <L3 DMEM access base address, size>,
       <L3 CMEM access base address, size>,
       <L3 SMEM access base address, size>,
       <L3 PMEM access base address, size>,
- interrupts: Interrupt number for AESS
- interrupt-parent: The parent interrupt controller
- ti,hwmods: Name of the hwmod associated to the AESS

Example:

aess: aess@401f1000 {
	compatible = "ti,omap4-aess";
	reg = <0x401f1000 0x3ff>, /* MPU private access */
	      <0x40180000 0xffff>, /* DMEM - MPU */
	      <0x401a0000 0x1fff>, /* CMEM - MPU */
	      <0x401ce000 0x5fff>, /* SMEM - MPU */
	      <0x401e0000 0x1fff>, /* PMEM - MPU */
	      <0x4901f000 0x3ff>, /* L3 Interconnect */
	      <0x49080000 0xffff>, /* DMEM - MPU */
	      <0x490a0000 0x1fff>, /* CMEM - MPU */
	      <0x490ce000 0x5fff>, /* SMEM - MPU */
	      <0x490e0000 0x1fff>; /* PMEM - MPU */
	interrupts = <0 99 0x4>;
	interrupt-parent = <&gic>;
	ti,hwmods = "aess";
};
```

## Documentation/devicetree/bindings/usb/dwc3.txt
```
synopsys DWC3 CORE

DWC3- USB3 CONTROLLER

Required properties:
 - compatible: must be "synopsys,dwc3"
 - reg : Address and length of the register set for the device
 - interrupts: Interrupts used by the dwc3 controller.
 - usb-phy : array of phandle for the PHY device

Optional properties:
 - tx-fifo-resize: determines if the FIFO *has* to be reallocated.
 - dr_mode: tells Dual-Role USB controllers that we want to work on a
 			particular mode. Valid arguments are "host",
 			"peripheral" and "otg". In case this attribute isn't
 			passed via DT, USB DRD controllers should default to
 			OTG.
- maximum-speed: tells USB controllers we want to work up to a certain
			speed. Valid arguments are "superspeed", "highspeed",
			"fullspeed" and "lowspeed". In case this isn't passed
			via DT, USB controllers should default to their maximum
			HW capability.
This is usually a subnode to DWC3 glue to which it is connected.

dwc3@4a030000 {
	compatible = "synopsys,dwc3";
	reg = <0x4a030000 0xcfff>;
	interrupts = <0 92 4>
	usb-phy = <&usb2_phy>, <&usb3,phy>;
	tx-fifo-resize;
};
```

## Documentation/devicetree/bindings/usb/omap3-ohci.txt
```
OMAP HS USB OHCI controller (OMAP3 and later)

Required properties:

- compatible: should be "ti,ohci-omap3"
- reg: should contain one register range i.e. start and length
- interrupt-parent: phandle to the interrupt controller
- interrupts: description of the interrupt line

Example for OMAP4:

usbhsohci: ohci@4a064800 {
	compatible = "ti,ohci-omap3", "usb-ohci";
	reg = <0x4a064800 0x400>;
	interrupt-parent = <&gic>;
	interrupts = <0 76 0x4>;
};
```

## Documentation/devicetree/bindings/watchdog/palmas-wdt.txt
```
* palmas and palmas-charger Watchdog IP block devicetree bindings

Required properties:
- compatible : Should be from the list
  ti,twl6035-wdt
  ti,twl6036-wdt
  ti,twl6037-wdt
  ti,tps65913-wdt
  ti,tps65914-wdt
  ti,tps80036-wdt
and also the generic series names
  ti,palmas-wdt

Examples:

wdt {
    compatible = "ti,twl6035-wdt", "ti,palmas-wdt";
    interrupt-parent = <&palmas>;
    interrupts = <10 0>;
    interrupt-name = "watchdog-irq";
};
```
