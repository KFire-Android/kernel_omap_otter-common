## drivers/staging/thermal_framework/sensor/Kconfig.omap
```kconfig
#
# Thermal sensors driver config
#
config TMP102_SENSOR
	bool "TMP102 temp sensor support"
	depends on OMAP_THERMAL && I2C
	help
	  Enabling this config will give support for the tmp102
	  temp sensor.

config TMP006_SENSOR
	bool "TMP006 temp sensor support"
	depends on OMAP_THERMAL && I2C
	help
	  Enabling this config will give support for the tmp006
	  temp sensor.

config OMAP_DIE_TEMP_SENSOR
	bool "Texas Instruments OMAP4+ on-die sensor support"
	depends on OMAP_BANDGAP && OMAP_THERMAL
	help
	  If you say yes here you get thermal support for the Texas Instruments
	  OMAP4+ SoC family. The current chip supported are:
	  - OMAP4460, OMAP4470, OMAP5430

	  This includes alert interrupts generation and also the TSHUT
	  support.

config THERMISTOR_SENSOR
	bool "OMAP Thermistor sensor support"
	depends on OMAP_THERMAL && TWL6030_GPADC
	help
	  Enabling this config will give support for the thermistor
	  temp sensor for the OMAP platform.

config CASE_TEMP_SENSOR
	bool "Case temp sensor support"
	depends on THERMAL_FRAMEWORK
	help
	  Enabling this config will give support for the case
	  temp sensor for the OMAP platform.
```

## drivers/staging/ti-st/Kconfig
```kconfig
#
# TI's shared transport line discipline and the protocol
# drivers (BT, FM and GPS)
#
menu "Texas Instruments shared transport line discipline"
config ST_FM
	tristate "fm driver for ST"
	depends on VIDEO_DEV
	select TI_ST
	help
	  This enables the FM driver for TI BT/FM/GPS combo devices
	  This makes use of shared transport line discipline core driver to
	  communicate with the FM core of the combo chip.

config ST_GPS
	tristate "gps driver for ST"
	select TI_ST
	help
	  This enables the GPS driver for TI WL128x BT/FM/GPS combo devices.
	  It will provide a character device for the TI GPS host software to
	  access the GPS core on the WL128x.
endmenu
```

## drivers/thermal/Kconfig
```kconfig
#
# Generic thermal sysfs drivers configuration
#

menuconfig THERMAL
	tristate "Generic Thermal sysfs driver"
	help
	  Generic Thermal Sysfs driver offers a generic mechanism for
	  thermal management. Usually it's made up of one or more thermal
	  zone and cooling device.
	  Each thermal zone contains its own temperature, trip points,
	  cooling devices.
	  All platforms with ACPI thermal support can use this driver.
	  If you want this support, you should say Y or M here.

config THERMAL_HWMON
	bool
	depends on THERMAL
	depends on HWMON=y || HWMON=THERMAL
	default y

config SPEAR_THERMAL
	bool "SPEAr thermal sensor driver"
	depends on THERMAL
	depends on PLAT_SPEAR
	help
	  Enable this to plug the SPEAr thermal sensor driver into the Linux
	  thermal framework

config OMAP_BANDGAP
	tristate "Texas Instruments OMAP4+ temperature sensor driver"
	depends on THERMAL
	depends on MFD_OMAP_CONTROL
	help
	  If you say yes here you get support for the Texas Instruments
	  OMAP4460+ on die bandgap temperature sensor support. The register
	  set is part of system control module.

	  This includes alert interrupts generation and also the TSHUT
	  support.

config OMAP4_BG_TEMP_SENSOR_DATA
	bool "Texas Instruments OMAP4 thermal support"
	depends on OMAP_BANDGAP
	depends on ARCH_OMAP4
	help
	  If you say yes here you get thermal support for the Texas Instruments
	  OMAP4 SoC family. The current chip supported are:
	   - OMAP4430
	   - OMAP4460
	   - OMAP4470

	  This includes alert interrupts generation and also the TSHUT
	  support.

config OMAP5_BG_TEMP_SENSOR_DATA
	bool "Texas Instruments OMAP5 thermal support"
	depends on OMAP_BANDGAP
	depends on ARCH_OMAP5 || ARCH_OMAP5_ES1
	help
	  If you say yes here you get thermal support for the Texas Instruments
	  OMAP5 SoC family. The current chip supported are:
	   - OMAP5430

	  This includes alert interrupts generation and also the TSHUT
	  support.
```

## drivers/video/omap2/Kconfig
```kconfig
config OMAP2_VRAM
	bool

config OMAP2_VRFB
	bool
	depends on ARCH_OMAP2 || ARCH_OMAP3
	default y if FB_OMAP2
	help
	  OMAP VRFB buffer support is efficient for rotation

source "drivers/video/omap2/dss/Kconfig"
source "drivers/video/omap2/omapfb/Kconfig"
source "drivers/video/omap2/displays/Kconfig"
```

## drivers/video/omap2/displays/Kconfig
```kconfig
menu "OMAP2/3 Display Device Drivers"
        depends on OMAP2_DSS

config PANEL_GENERIC
        tristate "Generic Panel"
	default y
        help
	  Generic panel driver.
	  Used for DVI output for Beagle and OMAP3 SDP.

config PANEL_SHARP_LS037V7DW01
        tristate "Sharp LS037V7DW01 LCD Panel"
        depends on OMAP2_DSS
	default y
        select BACKLIGHT_CLASS_DEVICE
        help
          LCD Panel used in TI's SDP3430 and EVM boards

config PANEL_SHARP_LQ043T1DG01
        tristate "Sharp LQ043T1DG01 LCD Panel"
        depends on OMAP2_DSS
        help

          LCD Panel used in TIs OMAP3517 EVM boards

config PANEL_PICO_DLP
        tristate "OMAP PICO DLP Panel"
        depends on OMAP2_DSS
        help
          LCD Panel used in TI's SDP4430 and EVM boards

config PANEL_TAAL
        tristate "Taal DSI Panel"
        depends on OMAP2_DSS_DSI
        help
          Taal DSI command mode panel from TPO.

config PANEL_NEC_NL8048HL11_01B
        tristate "NEC NL8048HL11-01B Panel"
	depends on OMAP2_DSS
	default y
        help
          LCD Panel used in the Zoom boards

config PANEL_SIL9022
       tristate "HDMI interface"
       help
               HDMI interface used in the Zoom board

config PANEL_TOPPOLY_TDO35S
        tristate "Toppoly TDO35S LCD Panel support"
        depends on OMAP2_DSS
        help
          LCD Panel used in CM-T35

config PANEL_TPO_TD043MTEA1
        tristate "TPO TD043MTEA1 LCD Panel"
        depends on OMAP2_DSS && SPI
        help
          LCD Panel used in OMAP3 Pandora

config PANEL_ACX565AKM
	tristate "ACX565AKM Panel"
	depends on OMAP2_DSS_SDI
	select BACKLIGHT_CLASS_DEVICE
	help
	  This is the LCD panel used on Nokia N900

config PANEL_OTTER1
        tristate "LGD Panel"
        depends on OMAP2_DSS
        help
          LCD Panel used in KC1 

config DEMO_HDMI
        tristate "HDMI output through ADI7526"
        depends on OMAP2_DSS
        help
          HDMI output used in KC1 DEMO
endmenu
```

## drivers/video/omap2/dss/Kconfig
```kconfig
menuconfig OMAP2_DSS
        tristate "OMAP2+ Display Subsystem support"
        help
	  OMAP2+ Display Subsystem support.

if OMAP2_DSS

config OMAP2_DSS_DEBUG
	bool "Debug support"
	default n
	help
	  This enables printing of debug messages. Alternatively, debug messages
	  can also be enabled by setting CONFIG_DYNAMIC_DEBUG and then setting
	  appropriate flags in <debugfs>/dynamic_debug/control.

config OMAP2_DSS_DEBUGFS
	bool "Debugfs filesystem support"
	depends on DEBUG_FS
	default n
	help
	  This enables debugfs for OMAPDSS at <debugfs>/omapdss. This enables
	  querying about clock configuration and register configuration of dss,
	  dispc, dsi, hdmi and rfbi.

config OMAP2_DSS_COLLECT_IRQ_STATS
	bool "Collect DSS IRQ statistics"
	depends on OMAP2_DSS_DEBUGFS
	default n
	help
	  Collect DSS IRQ statistics, printable via debugfs.

	  The statistics can be found from
	  <debugfs>/omapdss/dispc_irq for DISPC interrupts, and
	  <debugfs>/omapdss/dsi_irq for DSI interrupts.

config OMAP2_DSS_DPI
	bool "DPI support"
	default y
	help
	  DPI Interface. This is the Parallel Display Interface.

config OMAP2_DSS_DRA7XX_DPI
	bool "DRA75X DPI support"
	default n
	help
	  Vayu DPI Interface. This is the Parallel Display Interface.

config OMAP2_DSS_RFBI
	bool "RFBI support"
        default n
	help
	  MIPI DBI support (RFBI, Remote Framebuffer Interface, in Texas
	  Instrument's terminology).

	  DBI is a bus between the host processor and a peripheral,
	  such as a display or a framebuffer chip.

	  See http://www.mipi.org/ for DBI specifications.

config OMAP2_DSS_VENC
	bool "VENC support"
        default y
	help
	  OMAP Video Encoder support for S-Video and composite TV-out.

config OMAP4_DSS_HDMI
	bool "OMAP4 HDMI support"
	depends on ARCH_OMAP4 || ANDROID_SWITCH
        default y
	select I2C_ALGOBIT
	help
	  HDMI Interface. This adds the High Definition Multimedia Interface.
	  See http://www.hdmi.org/ for HDMI specification.

config OMAP4_DSS_HDMI_AUDIO
	bool

config OMAP5_DSS_HDMI_AUDIO
	bool
	depends on OMAP5_DSS_HDMI

config OMAP5_DSS_HDMI
	bool "OMAP5 HDMI support"
	depends on SOC_OMAP5
	depends on OMAP4_DSS_HDMI
	default y
	select PINCTRL_SINGLE
	select GPIO_PCA953X
	select MFD_PALMAS
	select REGULATOR_PALMAS
	help
	    HDMI Interface.This add the High Deinition Multimedia Interface.
	    See http://wwww.hdmi.org/ for HDMI specification.

config OMAP5_DSS_HDMI_DDC
	bool "OMAP5 HDMI DDC support"
	depends on OMAP5_DSS_HDMI
	default y
	help
	  HDMI DDC interface. This adds support for selecting DDC or I2C2 lines
	  for HDMI DDC transfer.
	  EDID can be read using direct I2C commands sent to the external display
	  over I2C lines or by configuring the DDC registers in the core.

config OMAP4_HDCP_SUPPORT
	bool "OMAP4 HDCP support"
	depends on OMAP4_DSS_HDMI
	default n
	help
	  High-bandwidth Digital Content Protection (HDCP).
	  This option required for OMAP4 HDCP support.

config OMAP2_DSS_SDI
	bool "SDI support"
        default n
	help
	  SDI (Serial Display Interface) support.

	  SDI is a high speed one-way display serial bus between the host
	  processor and a display.

config OMAP2_DSS_DSI
	bool "DSI support"
        default n
	help
	  MIPI DSI (Display Serial Interface) support.

	  DSI is a high speed half-duplex serial interface between the host
	  processor and a peripheral, such as a display or a framebuffer chip.

	  See http://www.mipi.org/ for DSI specifications.

config OMAP2_DSS_MIN_FCK_PER_PCK
	int "Minimum FCK/PCK ratio (for scaling)"
	range 0 32
	default 0
	help
	  This can be used to adjust the minimum FCK/PCK ratio.

	  With this you can make sure that DISPC FCK is at least
	  n x PCK. Video plane scaling requires higher FCK than
	  normally.

	  If this is set to 0, there's no extra constraint on the
	  DISPC FCK. However, the FCK will at minimum be
	  2xPCK (if active matrix) or 3xPCK (if passive matrix).

	  Max FCK is 173MHz, so this doesn't work if your PCK
	  is very high.

config OMAP2_DSS_SLEEP_AFTER_VENC_RESET
	bool "Sleep 20ms after VENC reset"
	default y
	help
	  There is a 20ms sleep after VENC reset which seemed to fix the
	  reset. The reason for the bug is unclear, and it's also unclear
	  on what platforms this happens.

	  This option enables the sleep, and is enabled by default. You can
	  disable the sleep if it doesn't cause problems on your platform.

config USE_FB_MODE_DB
	bool "Enable FB mode db support"
	default n
	select FB
	select FB_MODE_HELPERS
	select FB_OMAP2
	help
	  Enable FB mode support.

config SWITCH_STATE
	bool "Enable hpd switch state"
	depends on OMAP5_DSS_HDMI
	default n
	help
	  HDMI HDP switch state interface. This adds support for sending
	  HDMI HPD switch state events to user space.

config DISPLAY_SKIP_INIT
	bool "Skip display initialization during bootup"
	default n
	help
		This allows for skipping display initialization during bootup
		for cases where the display is initialized elsewhere - like
		u-boot or other processors

endif
```

## drivers/video/omap2/dsscomp/Kconfig
```kconfig
menuconfig DSSCOMP
	tristate "OMAP DSS Composition support (EXPERIMENTAL)"
	depends on EXPERIMENTAL && OMAP2_DSS && DRM_OMAP_DMM_TILER
	default n

	help
	  Frame composition driver using OMAP DSS2. Allows using
	  all DSS2 resources in a unified configuration. Should not
	  be used together with other DSS2 devices, such as V4L2
	  or OMAPFB.

config DSSCOMP_DEBUG_LOG
	bool "Log event timestamps in debugfs"
	default n
	depends on DEBUG_FS && DSSCOMP

	help
	  Takes timestamp for each callback and state transition, and
	  logs the last 128 entries (last few frames' worth) in a
	  log buffer.  This is a separate menuconfig in case this is
	  deemed an overhead.
```

## drivers/video/omap2/omaplfb/Kconfig
```kconfig
config OMAPLFB
        bool "In-kernel omaplfb: interface between display and kernel side PowerVR graphics driver"
        depends on OMAP2_DSS && DSSCOMP
	default y
	help
	  Support for in-kernel omaplfb. This is used by PVR kernel module.
```

## security/smc/Kconfig
```kconfig
config TF_ZEBRA
	bool

config TF_CRYPTO_RNG
	tristate "Use OMAP4 HW RNG"
	depends on ARCH_OMAP4 && m
	select SECURITY_MIDDLEWARE_COMPONENT
	default n
	help
	  This option enables OMAP4 HW RNG support.

	  If you are unsure how to answer this question, answer N.

config SECURITY_MIDDLEWARE_COMPONENT
	tristate "Enable SMC Driver"
	depends on ARCH_OMAP3 || ARCH_OMAP4
	default n
	select TF_ZEBRA
        select CRYPTO_SHA1 if ARCH_OMAP4
	help
	  This option adds kernel support for communication with the SMC
	  Protected Application.

	  If you are unsure how to answer this question, answer N.

config SMC_KERNEL_CRYPTO
	bool "Register SMC into kernel crypto subsytem"
	depends on SECURITY_MIDDLEWARE_COMPONENT
	default n
	help
	  This option enables crypto subsystem to use SMC and OMAP hardware
	  accelerators.

	  If you are unsure how to answer this question, answer N.

config SECURE_TRACE
	bool "Enable SMC secure traces"
	depends on SECURITY_MIDDLEWARE_COMPONENT && ARCH_OMAP4
	default y
	help
	  This option enables traces from the SMC Protected Application to be
	  displayed in kernel logs.

	  If you are unsure how to answer this question, answer Y.

config TF_DRIVER_DEBUG_SUPPORT
	bool "Debug support"
	depends on SECURITY_MIDDLEWARE_COMPONENT
	default n
	help
	  This options enables debug traces in the driver.

	  If you are unsure how to answer this question, answer N.

config TF_DRIVER_CRYPTO_FIPS
	bool "FIPS compliance support"
	depends on SMC_KERNEL_CRYPTO && ARCH_OMAP4 && MODULE_EXTRA_COPY
	default n
	help
          This option enables features for FIPS certification of the SMC
          cryptographic driver: built-in test vectors for POST, and a
          device for user space programs to submit more test vectors.

          If you are unsure how to answer this question, answer N.

config TF_DRIVER_FAULT_INJECTION
	bool "Fault injection support"
	depends on TF_DRIVER_CRYPTO_FIPS && ARCH_OMAP4
	default n
	help
	  This option allows forcing cryptographic operations in the SMC
	  driver to fail.

	  If you are unsure how to answer this question, answer N.
```
