## drivers/misc/ti-st/Kconfig
```kconfig
#
# TI's shared transport line discipline and the protocol
# drivers (BT, FM and GPS)
#
menu "Texas Instruments shared transport line discipline"
config TI_ST
	tristate "Shared transport core driver"
	depends on NET && GPIOLIB
	select FW_LOADER
	help
	  This enables the shared transport core driver for TI
	  BT / FM and GPS combo chips. This enables protocol drivers
	  to register themselves with core and send data, the responses
	  are returned to relevant protocol drivers based on their
	  packet types.

config ST_GPS
	tristate "gps driver for ST"
	select TI_ST
	help
	  This enables the GPS driver for TI BT/FM/GPS combo devices.
	  It will provide a character device for the TI GPS host software to
	  access the GPS core.
endmenu
```

## drivers/net/caif/phy/Kconfig
```kconfig
# Include EMP CAIF Physical drivers physical drivers
# sourced "drivers/net/caif/Kconfig"

# Some options here should be made platform dependent

menu "CAIF ZOOM2/ZOOM3/BLAZE low level physical drivers"
	depends on CAIF && MACH_OMAP_ZOOM2 || MACH_OMAP_ZOOM3 || ARCH_OMAP4 || ARCH_OMAP5

config CAIF_HSI_OMAP
	tristate "CAIF HSI OMAP driver"
	default n
	depends on ARCH_OMAP4 || ARCH_OMAP5
	---help---
	CAIF OMAP HSI driver using the OMAP HSI interface.
	This driver is required if you want to use CAIF HSI with OMAP.

	Say Y here to compile support for CAIF HSI OMAP devices into the
	kernel or say M to compile it as module.

config CAIF_PHY_GPIO_AWR
	int "AWR GPIO pin"
	default "23"
	depends on CAIF_TTY && CAIF_TTY_PM
	---help---
	Output GPIO pin for the modem AWR signal.

config CAIF_PHY_GPIO_CWR
	int "CWR GPIO pin"
	default "156"
	depends on CAIF_TTY && CAIF_TTY_PM
	---help---
	Input GPIO pin for the modem CWR signal.

endmenu
```

## drivers/omap_hsi/Kconfig
```kconfig
#
# OMAP HSI driver configuration
#

config OMAP_HSI
	bool "OMAP HSI hardware driver"
	depends on (ARCH_OMAP3 || ARCH_OMAP4 || ARCH_OMAP5)
	default n
	---help---
	  If you say Y here, you will enable the OMAP HSI hardware driver.

	  Note: This module is a unified driver specific to OMAP. Efforts are
	  underway to create a vendor independent implementation.

	  The MIPI HSI is a High Speed Synchronous Serial Interface and is
	  defined for communication between two Integrated Circuits (the
	  typical scenario is an application IC and cellular modem IC
	  communication). Data transaction model is peer-to-peer.

	  Not all features required for a production device are implemented in
	  this driver. See the documentation for more information.

	  This physical layer provides logical channeling and several modes of
	  operation.

	  The OMAP HSI driver supports either:
	    - the OMAP MIPI HSI device
	    - the OMAP SSI device

choice
	prompt "Selected device support file"
	depends on OMAP_HSI && y
	default OMAP_HSI_DEVICE
	---help---
	  Adds the device support for one of the devices handled by the HSI
	  driver.

	  The OMAP HSI driver supports either:
	    - the OMAP MIPI HSI device
	    - the OMAP SSI device

config OMAP_HSI_DEVICE
	bool "HSI (OMAP MIPI HSI)"
	depends on (ARCH_OMAP4 || ARCH_OMAP5)
	---help---
	  The MIPI High Speed Synchronous Serial Interface (HSI) is a high
	  speed communication interface that is used for connecting OMAP
	  to another IC.

	  The MIPI HSI support is mainly selected by the OMAP architecture
	  version.
	  For more details, refer to the documentation.

config OMAP_SSI_DEVICE
	bool "SSI (OMAP SSI)"
	depends on ARCH_OMAP3
	---help---
	  Synchronous Serial Interface (SSI) is a high speed communication
	  interface that is used for connecting OMAP to another IC.

	  The SSI support is mainly selected by the OMAP architecture
	  version.

endchoice

#
# OMAP HSI char device kernel configuration
#

config OMAP_HSI_CHAR
	tristate "OMAP HSI character driver"
	depends on OMAP_HSI
	---help---
	  If you say Y here, you will enable the OMAP HSI character driver.

	  This driver provides a simple character device interface for
	  serial communication over the HSI bus.
	  It can be compiled as a module.
```

## drivers/power/kc1_summit/Kconfig
```kconfig
config SUMMIT_SMB347_Q
	bool "SUMMIT smb347 charger driver"
	help
	  Say Y here if you want to enable SUMMIT smb347.
	  If unsure, say Y.
```

## drivers/remoteproc/Kconfig
```kconfig
menu "Remoteproc drivers"

# REMOTEPROC gets selected by whoever wants it
config REMOTEPROC
	tristate
	depends on HAS_DMA
	select CRC32
	select FW_LOADER
	select VIRTIO

# OMAP_REMOTEPROC depends on selection of IPU or DSP instances
config OMAP_REMOTEPROC
	tristate "OMAP remoteproc support"
	depends on HAS_DMA
	depends on ARCH_OMAP4 || SOC_OMAP5 || SOC_DRA7XX
	depends on OMAP_IOMMU
	depends on CMA
	select REMOTEPROC
	select MAILBOX
	select OMAP2PLUS_MBOX
	select RPMSG
	help
	  Support for OMAP's remote processors (dual Cortex-M3/M4
	  and DSP) via the remote processor framework.

	  Currently supported on OMAP4, OMAP5 & DRA7XX SoCs.

	  It gets selected by DSP(2) or IPU(1) OMAP_REMOTEPROC instances,
	  in order to enable multimedia use-cases to run on your platform
	  (multimedia codecs are offloaded to remote DSP processors or
	  remoteproc processors controlling other h/w accelerator devices
	  using this framework).

config OMAP_REMOTEPROC_IPU
	bool "OMAP remoteproc support for IPU"
	depends on OMAP_REMOTEPROC
	help
	  Say Y here if you want to enable OMAP's IPU remote processor.

	  This option controls only the dual Cortex-M3/M4 processor sub-system.
	  You would want to say y here usually, as this is the sub-system where
	  typically video & imaging codec control s/w is offloaded.

	  It's safe to say n here if you're not interested in multimedia
	  offloading (by IPU) or just want a bare minimum kernel.

config OMAP_REMOTEPROC_DSP
	bool "OMAP remoteproc support for DSP"
	depends on OMAP_REMOTEPROC
	help
	  Say Y here if you want to enable OMAP's DSP remote processor.

	  This option controls only the DSP processor sub-system. DSP would
	  typically be used to offload audio codecs or other advanced
	  processing algorithms.

	  It's safe to say n here if you're not interested in offloading
	  audio or any other algorithm (by DSP) or just want a bare minimum kernel.

config OMAP_REMOTEPROC_IPU1
	bool "OMAP remoteproc support for IPU1 (DRA7xx only)"
	depends on OMAP_REMOTEPROC && SOC_DRA7XX
	help
	  Say Y here if you want to enable DRA7xx's IPU1 remote processor.

	  This option controls only the first dual-M4 processor sub-system in
	  DRA7xx. You would want to say y here usually, as this is the sub
	  system where some real-time automative stack s/w is offloaded.

	  It's safe to say n here if you're not interested in enabling IPU1
	  or just want a bare minimum kernel.

config OMAP_REMOTEPROC_DSP2
	bool "OMAP remoteproc support for DSP2 (DRA7xx only)"
	depends on OMAP_REMOTEPROC && SOC_DRA7XX
	help
	  Say Y here if you want to enable DRA7xx's DSP2 remote processor.

	  This option controls only the DSP2 processor sub-system in DRA7xx.
	  DSP would typically be used to offload audio codecs or other advanced
	  processing algorithms.

	  It's safe to say n here if you're not interested in offloading
	  audio or any other algorithm (by DSP) or just want a bare minimum
	  kernel.

config STE_MODEM_RPROC
	tristate "STE-Modem remoteproc support"
	depends on HAS_DMA
	select REMOTEPROC
	default n
	help
	  Say y or m here to support STE-Modem shared memory driver.
	  This can be either built-in or a loadable module.
	  If unsure say N.

config DA8XX_REMOTEPROC
	tristate "DA8xx/OMAP-L13x remoteproc support"
	depends on ARCH_DAVINCI_DA8XX
	select CMA
	select REMOTEPROC
	select RPMSG
	help
	  Say y here to support DA8xx/OMAP-L13x remote processors via the
	  remote processor framework.

	  You want to say y here in order to enable AMP
	  use-cases to run on your platform (multimedia codecs are
	  offloaded to remote DSP processors using this framework).

	  This module controls the name of the firmware file that gets
	  loaded on the DSP.  This file must reside in the /lib/firmware
	  directory.  It can be specified via the module parameter
	  da8xx_fw_name=<filename>, and if not specified will default to
	  "rproc-dsp-fw".

	  It's safe to say n here if you're not interested in multimedia
	  offloading.

endmenu
```

## drivers/rpmsg/Kconfig
```kconfig
menu "Rpmsg drivers (EXPERIMENTAL)"

# RPMSG always gets selected by whoever wants it
config RPMSG
	tristate
	select VIRTIO
	select VIRTIO_RING
	depends on EXPERIMENTAL

config RPMSG_RESMGR_FWK
	tristate
	depends on RPMSG
	---help---
	  Add a framework based on RPMSG to request and release
	  resources from a remote Processor. This generic layer
	  takes advantage of RPMSG to exchange messages with the
	  remote processor

	  If unsure, say N.

config RPMSG_RESMGR
	tristate "Resource Manager based on RPMSG"
	depends on RPMSG
	select RPMSG_RESMGR_FWK
	---help---
	  Add the request and release mechanisms for various resources
	  that can be made avaiable for the remote processors in an SoC.
	  The resource manager ensures aribitration of resources requests
	  from any remote processor within the SoC

	  If unsure, say N.

config OMAP_RPMSG_RESMGR
	tristate "OMAP rpmsg resource manager support"
	depends on ARCH_OMAP4 || ARCH_OMAP5
	depends on RPMSG
	select RPMSG_RESMGR
	---help---
	  Add OMAP SoC specific request and release OMAP resources
	  from a remote Processor. This extends the generic RPMSG_RESMGR
	  to support OMAP specific resources. Common resources requested by
	  a remote processor in the SoC include gptimers, sdma channels,
	  auxiliary clocks,etc.

	  If unsure, say N.

config RPMSG_OMX
	tristate "rpmsg OMX driver"
	depends on RPMSG
	---help---
	  An rpmsg driver that exposes OMX API to user space, in order to
	  allow multimedia applications to offload OMX processing to
	  remote processors.

	  If unsure, say N.

endmenu
```

## drivers/staging/omapdrm/Kconfig
```kconfig
menuconfig DRM_OMAP
	tristate "OMAP DRM"
	depends on ARCH_OMAP2PLUS && DRM
	default n
	help
	  If you want to use the OMAP DRM Display driver and/or DMM/Tiler
	  driver, enable this.

config DRM_OMAP_DISPLAY
	tristate "OMAP DRM Display Driver"
	depends on DRM_OMAP && !CONFIG_FB_OMAP2
	select DRM_KMS_HELPER
	select OMAP2_DSS
	select FB_SYS_FILLRECT
	select FB_SYS_COPYAREA
	select FB_SYS_IMAGEBLIT
	select FB_SYS_FOPS
	select DRM_OMAP_DMM_TILER
	default y
	help
	  DRM display driver for OMAP2/3/4 based boards.

config DRM_OMAP_NUM_CRTCS
	depends on DRM_OMAP_DISPLAY
	int "Number of CRTCs"
	range 1 10
	default 1  if ARCH_OMAP2 || ARCH_OMAP3
	default 2  if ARCH_OMAP4
	help
	  Select the number of video overlays which can be used as framebuffers.
	  The remaining overlays are reserved for video.

config DRM_OMAP_DMM_TILER
	tristate "OMAP DMM TILER"
	depends on DRM_OMAP
	default y
	help
	  Enable the DMM/Tiler driver for OMAP4+ boards.
```

## drivers/staging/omaprpc/Kconfig
```kconfig
config RPC_OMAP
	tristate "OMAP Remote Procedure Call driver"
	default y
	depends on RPMSG
	depends on (TI_TILER && ION_OMAP) || (DMA_SHARED_BUFFER && DRM_OMAP)
	depends on REMOTEPROC || REMOTE_PROC
	depends on OMAP_REMOTEPROC || OMAP_REMOTE_PROC
	---help---
	  An rpmsg driver that exposes the Remote Procedure Call API to
	  user space, in order to allow applications to distribute
	  remote calls to more power-efficient remote processors on OMAP4+ systems.

	  If unsure, say N.
```

## drivers/staging/thermal_framework/Kconfig
```kconfig
#
# Generic Thermal Framework drivers configuration
#

menuconfig THERMAL_FRAMEWORK
	bool "Thermal Framework support"
	default y
	help
	  This is a generic thermal framework which will be used as
	  a central hub for sensors, governors and cooling devices
	  to register and pass data to.


config THERMAL_FRAMEWORK_DEBUG
	bool "Thermal Framework Debug support"
	depends on THERMAL_FRAMEWORK && DEBUG_FS
	default n
	help
	  Say 'Y' here if you want to have the debugfs support for
	  the Thermal Framework. The debugfs support will create
	  debug files under DEBUG_FS to represent the thermal
	  components, e.g. thermal domains, governors, sensors and
	  cooling devices and their attributes.

source "drivers/staging/thermal_framework/Kconfig.omap_thermal"

source "drivers/staging/thermal_framework/Kconfig.duty_cycle"
```

## drivers/staging/thermal_framework/Kconfig.duty_cycle
```kconfig
#
# DC drivers configuration
#

config OMAP4_DUTY_CYCLE
	bool "Control OPP_NITRO usage based on duty cycle strategy"
	depends on THERMAL_FRAMEWORK && ARCH_OMAP4 && CPU_FREQ
	default y
	help
	If you are going to use OPP_NITRO with high level of leakage which.
	could pontentially sustain a thermal runaway, say Y here.

source "drivers/staging/thermal_framework/governor/Kconfig.dc_governor"
```

## drivers/staging/thermal_framework/Kconfig.omap_thermal
```kconfig
config OMAP_THERMAL
	bool "OMAP Thermal Framework support"
	depends on THERMAL_FRAMEWORK && ARCH_OMAP4
	default y
	help
	  This is the thermal framework support for OMAP4
	  processors.

source "drivers/staging/thermal_framework/sensor/Kconfig.omap"
source "drivers/staging/thermal_framework/governor/Kconfig.omap"
```

## drivers/staging/thermal_framework/cooling_devices/Kconfig.omap
```kconfig
#
# Thermal cooling devices configuration
#

config DUMMY_USER_COOLING
	tristate "Dummy cooling device support"
	depends on THERMAL_FRAMEWORK
	help
	  Enabling this config will give support for the a cooling
	  device which will be sending sysfs notifications to user
	  userspace, so that applications thermal aware can be interrupted
	  when there is a change in the cooling level for a specific domain.
```

## drivers/staging/thermal_framework/governor/Kconfig
```kconfig
#
# Thermal governor driver config
#

config OMAP_DIE_GOVERNOR
	bool "OMAP On Die thermal governor support"
	help
	  This is the governor for the OMAP4/OMAP5 On-Die temperature sensors.
	  This governer will institute the policy to call specific
	  cooling agents.
```

## drivers/staging/thermal_framework/governor/Kconfig.dc_governor
```kconfig
#
# Duty cycle governor driver config
#

config OMAP4_DUTY_CYCLE_GOVERNOR
	bool "OMAP duty cycle governor support"
	depends on OMAP4_DUTY_CYCLE
	default n
	help
	  This is the governor for the OMAP4 duty cycle.
	  This governor will instituted the policy to define
	  aggressiveness of duty cycle. The governor changes duty cycle
	  threshold, depending on the PCB temperature sensor
```

## drivers/staging/thermal_framework/governor/Kconfig.omap
```kconfig
#
# Thermal governor driver config
#
config OMAP_DIE_GOVERNOR
	bool "OMAP On Die thermal governor support"
	depends on OMAP_THERMAL
	help
	  This is the governor for the OMAP4 and OMAP5 On-Die
	  temperature sensors.
	  This governer will institute the policy to call specific
	  cooling agents.

config CASE_TEMP_GOVERNOR
	bool "Case thermal governor support"
	depends on OMAP_THERMAL
	help
	  This is the governor for the Case temperature sensor.
	  This governer will institute the policy to call specific
	  cooling agents.
```

## drivers/staging/thermal_framework/sensor/Kconfig
```kconfig
#
# Thermal sensors driver config
#
config TMP102_SENSOR
	bool "TMP102 temp sensor support"
	depends on THERMAL_FRAMEWORK && I2C
	help
	  Enabling this config will give support for the tmp102
	  temp sensor.

config TMP006_SENSOR
	bool "TMP006 temp sensor support"
	depends on THERMAL_FRAMEWORK && OMAP_THERMAL && I2C
	help
	  Enabling this config will give support for the tmp006
	  temp sensor.

config OMAP5_THERMAL
	bool "Texas Instruments OMAP5 thermal support"
	depends on OMAP_BANDGAP
	depends on ARCH_OMAP5
	depends on THERMAL_FRAMEWORK
	help
	  If you say yes here you get thermal support for the Texas Instruments
	  OMAP5 SoC family. The current chip supported are:
	  - OMAP5430

	  This includes alert interrupts generation and also the TSHUT
	  support.
```
